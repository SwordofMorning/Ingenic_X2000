## vendor/module_driver/package/drivers/hci_uart_h5_kernel_5_10_21/Config.in
```kconfig
config MD_BT_HCIUART_RTKH5_KERNEL_5_10_21
    bool "Realtek H5 protocol support(kernel 5.10.21 )"
```

## vendor/module_driver/package/drivers/pwm_audio/Config.in
```kconfig
config MD_PWM_AUDIO
    bool "PMW 模拟声卡驱动"
    default n

config MD_PWM_AUDIO_PWM_GPIO_1
    string "声卡1 pwm 引脚"
    choice from SOC_GPIO_PINS
    depends on MD_PWM_AUDIO
    default -1

config MD_PWM_AUDIO_AMP_POWER_GPIO_1
    string "声卡1 功放使能引脚"
    choice from SOC_GPIO_PINS
    depends on MD_PWM_AUDIO
    default -1

config MD_PWM_AUDIO_AMP_MUTE_UP_TIME_1
    string "声卡1 功放使能前时需要输出静音时间(ms)"
    default 1

config MD_PWM_AUDIO_AMP_MUTE_DOWN_TIME_1
    string "声卡1 功放失能后时需要输出静音时间(ms)"
    default 500

config MD_PWM_AUDIO_PWM_GPIO_2
    string "声卡2 pwm 引脚"
    choice from SOC_GPIO_PINS
    depends on MD_PWM_AUDIO
    default -1

config MD_PWM_AUDIO_AMP_POWER_GPIO_2
    string "声卡2 功放使能引脚"
    choice from SOC_GPIO_PINS
    depends on MD_PWM_AUDIO
    default -1


config MD_PWM_AUDIO_AMP_MUTE_UP_TIME_2
    string "声卡2 功放使能前时需要输出静音时间(ms)"
    default 1

config MD_PWM_AUDIO_AMP_MUTE_DOWN_TIME_2
    string "声卡2 功放失能后需要输出静音时间(ms)"
    default 500
```

## vendor/module_driver/package/soc/ad100_510/Config.in
```kconfig
menuconfig MD_SOC_AD100_510
    bool "ad100驱动列表"
    depends on MD_CHOICE_SOC_AD100_510_BASE

config MD_SOC_DIR
    string
    default soc/ad100_510

source package/soc/ad100_510/def_gpio_pins.in

source package/soc/ad100_510/gpio/Config.in
source package/soc/ad100_510/watchdog/Config.in
source package/soc/ad100_510/watchdog1_timer/Config.in
source package/soc/ad100_510/efuse/Config.in
source package/soc/ad100_510/aes/Config.in
source package/soc/ad100_510/dtrng/Config.in
source package/soc/ad100_510/adc/Config.in
source package/soc/ad100_510/audio_dma/Config.in
source package/soc/ad100_510/icodec/Config.in
source package/soc/ad100_510/dmic/Config.in
source package/soc/ad100_510/hash/Config.in
source package/soc/ad100_510/msc/Config.in
source package/soc/ad100_510/pwm/Config.in
source package/soc/ad100_510/spi/Config.in
source package/soc/ad100_510/sslv/Config.in
source package/soc/ad100_510/i2c/Config.in
source package/soc/ad100_510/fb_layer_mixer/Config.in
source package/soc/ad100_510/fb/Config.in
source package/soc/ad100_510/aic/Config.in
source package/soc/ad100_510/mac/Config.in
source package/soc/ad100_510/utils/Config.in

endmenu
```

## vendor/module_driver/package/soc/ad100_510/adc/Config.in
```kconfig
menuconfig MD_AD100_510_ADC
    bool "adc 驱动(电压采样功能)"

config MD_AD100_510_ADC_VREF
    int "参考电压mv"
    default 1800

endmenu
```

## vendor/module_driver/package/soc/ad100_510/dmic/Config.in
```kconfig
menuconfig MD_AD100_510_DMIC
    bool "dmic(外接数字mic)"
    select MD_AD100_510_AUDIO_DMA

config MD_AD100_510_DMIC_INT0
    bool "使能dmic通道0,1（PC05）"
    default y

config MD_AD100_510_CLK_SELECT
    bool "dmic 工作频率"
    default y

choice "dmic 工作频率"
    default MD_AD100_510_CLK_2400KHz
    depends on  MD_AD100_510_CLK_SELECT

config MD_AD100_510_CLK_2400KHz
    bool "选择dmic的工作频率为2.4MHz"

config MD_AD100_510_CLK_3072KHz
    bool "选择dmic的工作频率为3.072MHz"

endchoice

endmenu #MD_AD100_510_DMIC
```

## vendor/module_driver/package/soc/ad100_510/i2c/Config.in
```kconfig
menuconfig MD_AD100_510_I2C
    bool "i2c 控制器驱动"


config MD_AD100_510_I2C0_BUS
    bool "选择I2C0"

choice "              选择I2C0 GPIO"
    default MD_AD100_510_I2C0_PC
    depends on MD_AD100_510_I2C0_BUS

config MD_AD100_510_I2C0_PC
    bool "SCL:GPIO_PC(0) SDA:GPIO_PC(1)"

config MD_AD100_510_I2C0_PD
    bool "SCL:GPIO_PD(4) SDA:GPIO_PD(3)"

endchoice

config MD_AD100_510_I2C0_RATE
    int "       I2C0 速度 "
    default 400000
    depends on MD_AD100_510_I2C0_BUS



config MD_AD100_510_I2C1_BUS
    bool "选择I2C1"

choice "              选择I2C1 GPIO"
    default MD_AD100_510_I2C1_PB
    depends on MD_AD100_510_I2C1_BUS

config MD_AD100_510_I2C1_PB
    bool "SCL:GPIO_PB(0) SDA:GPIO_PB(1)"

config MD_AD100_510_I2C1_PC
    bool "SCL:GPIO_PC(2) SDA:GPIO_PC(3)"

endchoice

config MD_AD100_510_I2C1_RATE
    int "        I2C1 速度 "
    default 400000
    depends on MD_AD100_510_I2C1_BUS



config MD_AD100_510_I2C2_BUS
    bool "选择I2C2"

choice "              选择I2C2 GPIO"
    default MD_AD100_510_I2C2_PB
    depends on MD_AD100_510_I2C2_BUS

config MD_AD100_510_I2C2_PB
    bool "SCL:GPIO_PB(3) SDA:GPIO_PB(2)"

config MD_AD100_510_I2C2_PC
    bool "SCL:GPIO_PC(19) SDA:GPIO_PC(20)"

endchoice

config MD_AD100_510_I2C2_RATE
    int "       I2C2 速度 "
    default 400000
    depends on MD_AD100_510_I2C2_BUS



config MD_AD100_510_I2C3_BUS
    bool "选择I2C3"

choice "              选择I2C3 GPIO"
    default MD_AD100_510_I2C3_PE
    depends on MD_AD100_510_I2C3_BUS

config MD_AD100_510_I2C3_PE
    bool "SCL:GPIO_PE(5) SDA:GPIO_PE(6)"

config MD_AD100_510_I2C3_PC
    bool "SCL:GPIO_PC(21) SDA:GPIO_PC(22)"

endchoice

config MD_AD100_510_I2C3_RATE
    int "       I2C3 速度 "
    default 400000
    depends on MD_AD100_510_I2C3_BUS



endmenu
```

## vendor/module_driver/package/soc/ad100_510/spi/Config.in
```kconfig
array SOC_AD100_510_SPI0_CLK_IO
    string "SPI0 CLK 引脚"
    item "GPIO_NULL  " -1
    item "PB03" PB03
    item "PD00" PD00

array SOC_AD100_510_SPI0_MISO_IO
    string "SPI0 MISO(DR) 引脚"
    item "GPIO_NULL  " -1
    item "PB01" PB01
    item "PD02" PD02

array SOC_AD100_510_SPI0_MOSI_IO
    string "SPI0 MOSI(DT) 引脚"
    item "GPIO_NULL  " -1
    item "PB02" PB02
    item "PD01" PD01


array SOC_AD100_510_SPI0_CLK_I1
    string "SPI0 CLK 引脚"
    item "GPIO_NULL  " -1
    item "PC15" PC15
    item "PC25" PC25

array SOC_AD100_510_SPI0_MISO_I1
    string "SPI0 MISO(DR) 引脚"
    item "GPIO_NULL  " -1
    item "PC17" PC17
    item "PC27" PC27

array SOC_AD100_510_SPI0_MOSI_I1
    string "SPI0 MOSI(DT) 引脚"
    item "GPIO_NULL  " -1
    item "PC16" PC16
    item "PC26" PC26



menu "SPI 总线"
    help
        "依赖于 SPI 驱动"

config MD_AD100_510_SPI
    bool

config MD_AD100_510_SPI_CLK_RATE
    int "SPI内部时钟源频率(单位Hz)"
    default 100000000
    help
            SPI频率 = SPI内部时钟源频率 / (2 * (CGV + 1))
            CGV范围: 0 ~ 255
            当前SPI频率范围: 195312.5 ~ 50000000



config MD_AD100_510_SPI0
    bool "选择 SPI0"
    select MD_AD100_510_SPI

config MD_AD100_510_SPI0_CLK
    string "        CLK(时钟引脚)"
    default PD00
    choice from SOC_AD100_510_SPI0_CLK_IO
    depends on MD_AD100_510_SPI0

config MD_AD100_510_SPI0_MISO
    string "        MISO(输入引脚)"
    default PD02
    choice from SOC_AD100_510_SPI0_MISO_IO
    depends on MD_AD100_510_SPI0
    help
        "MISO= -1,表示不使用MISO引脚"

config MD_AD100_510_SPI0_MOSI
    string "        MOSI(输出引脚)"
    default PD01
    choice from SOC_AD100_510_SPI0_MOSI_IO
    depends on MD_AD100_510_SPI0
    help
        "MOSI= -1,表示不使用MOSI引脚"


config MD_AD100_510_SPI1
    bool "选择 SPI1"
    select MD_AD100_510_SPI

config MD_AD100_510_SPI1_CLK
    string "        CLK(时钟引脚)"
    default PC25
    choice from SOC_AD100_510_SPI0_CLK_I1
    depends on MD_AD100_510_SPI1

config MD_AD100_510_SPI1_MISO
    string "        MISO(输入引脚)"
    default PC27
    choice from SOC_AD100_510_SPI0_MISO_I1
    depends on MD_AD100_510_SPI1
    help
        "MISO= -1,表示不使用MISO引脚"

config MD_AD100_510_SPI1_MOSI
    string "        MOSI(输出引脚)"
    default PC26
    choice from SOC_AD100_510_SPI0_MOSI_I1
    depends on MD_AD100_510_SPI1
    help
        "MOSI= -1,表示不使用MOSI引脚"

endmenu # SPI 总线
```

## vendor/module_driver/package/soc/ad100_510/utils/Config.in
```kconfig
menuconfig MD_AD100_510_UTILS
    bool "utils 驱动(芯片的一些小功能)"

config MD_AD100_510_UTILS_CLK24M
    bool "clk24m 时钟bypas输出(PE02)"
    default y

config MD_AD100_510_UTILS_CLK24M_INIT_ON
    bool "        初始化即使能clk24m输出"
    depends on MD_AD100_510_UTILS_CLK24M

config MD_AD100_510_UTILS_RTC32K
    bool "rtc32k 时钟bypas输出(PE00) (未实现)"
    default y

config MD_AD100_510_UTILS_RTC32K_INIT_ON
    bool "        初始化即使能rtc32k输出"
    depends on MD_AD100_510_UTILS_RTC32K

endmenu
```

## vendor/module_driver/package/soc/ad100_510/watchdog/Config.in
```kconfig
menuconfig MD_AD100_510_WATCHDOG
    bool "watchdog 驱动(看门狗)"

config MD_AD100_510_WDT0_BUS
    bool "选择watchdog0"
    default n

config MD_AD100_510_WDT1_BUS
    bool "选择watchdog1"
    default n

endmenu
```

## vendor/module_driver/package/soc/x1600/aic/Config.in
```kconfig
menuconfig MD_X1600_AIC
    bool "aic(i2s 接口)"

menuconfig MD_X1600_AIC_IF_SEND_INVALID_DATA
    bool "外部codec是否需要在传输有效数据之前先传输空数据至传输稳定"
    default y

config MD_X1600_AIC_IF_SEND_INVALID_DATA_EVERYTIME
    bool "每次播放均先传输空数据至稳定"
    default n
    help
        若不选中该项 仅上电后首次播放先传输空数据至稳定

config MD_X1600_AIC_SEND_INVALID_DATA_TIME_MS
    int "需要先传输空数据至传输稳定的时长(以ms为单位)"
    default 120
    help
        基于halley6_x1600_v10板极测得播放音频为8k时对应时间为720
        16k为360 48k为120 96k为60

endmenu

config MD_X1600_AIC_SELECT_CLOCK
    int "选择rx和tx的时钟是否独立"
    choice from MD_x1600_AIC_CLK_CHOICE_LIST
    help
        时钟完全独立指tx和rx的mclk、bclk、lrclk相互独立
        时钟共享tx_mclk指i2s的tx和rx共享tx_mclk，但bclk和lrclk独立
        时钟完全共享指tx和rx的mclk、bclk、lrclk相互共享

endmenu # aic(i2s 接口)

array MD_x1600_AIC_CLK_CHOICE_LIST
    int "选择rx和tx的时钟选项"
    item "i2s rx和tx的时钟完全独立" 0
    item "i2s rx和tx共享tx_mclk" 1
    item "i2s rx和tx共享所有的时钟" 2
```

## vendor/module_driver/package/soc/x2000/efuse/Config.in
```kconfig
menuconfig MD_X2000_EFUSE
    bool "efuse 驱动(芯片熔丝功能)"

config MD_X2000_EFUSE_VDDQ
    string "efuse 写使能引脚"
    choice from SOC_GPIO_PINS
    default -1

choice "选择读写efuse段的校验模式"
    default MD_X2000_VERIFY_MODE_NONE
config MD_X2000_VERIFY_MODE_HAMMING
    bool "使用海明码对原始数据进行编码"
config MD_X2000_VERIFY_MODE_NONE
    bool "不使用编码校验功能，读写原始数据"
endchoice

endmenu
```

## vendor/module_driver/package/soc/x2000/nemc/Config.in
```kconfig
array NEMC_BUSWIDTH
    int "NEMC 数据总线位宽"
    item "8位" 8
    item "16位" 16

menuconfig MD_X2000_NEMC
    bool "nemc 外部总线接口"

menu "使能 nemc 地址线引脚"

config MD_X2000_NEMC_ADDR0_GPIO
    bool "使能addr0 (PB00)"
    default y
config MD_X2000_NEMC_ADDR1_GPIO
    bool "使能addr1 (PB01)"
    default y
config MD_X2000_NEMC_ADDR2_GPIO
    bool "使能addr2 (PB02)"
    default y
config MD_X2000_NEMC_ADDR3_GPIO
    bool "使能addr3 (PB03)"
    default y
config MD_X2000_NEMC_ADDR4_GPIO
    bool "使能addr4 (PB04)"
    default y
config MD_X2000_NEMC_ADDR5_GPIO
    bool "使能addr5 (PB05)"
    default y
config MD_X2000_NEMC_ADDR6_GPIO
    bool "使能addr6 (PB06)"
    default y
config MD_X2000_NEMC_ADDR7_GPIO
    bool "使能addr7 (PB07)"
    default y
config MD_X2000_NEMC_ADDR8_GPIO
    bool "使能addr8 (PB08)"
    default n
config MD_X2000_NEMC_ADDR9_GPIO
    bool "使能addr9 (PB09)"
    default n
config MD_X2000_NEMC_ADDR10_GPIO
    bool "使能addr10 (PB10)"
    default n
config MD_X2000_NEMC_ADDR11_GPIO
    bool "使能addr11 (PB11)"
    default n
config MD_X2000_NEMC_ADDR12_GPIO
    bool "使能addr12 (PB12)"
    default n

endmenu

config MD_X2000_NEMC0
    bool "使能 nemc0"

config MD_X2000_NEMC0_BUSWIDTH
    int "nemc0 数据总线位宽"
    choice from NEMC_BUSWIDTH
    depends on MD_X2000_NEMC0


config MD_X2000_NEMC1
    bool "使能 nemc1"

config MD_X2000_NEMC1_BUSWIDTH
    int "nemc1 数据总线位宽"
    choice from NEMC_BUSWIDTH
    depends on MD_X2000_NEMC1

endmenu
```

## vendor/module_driver/package/soc/x2580/Config.in
```kconfig
menuconfig MD_SOC_X2580
    bool "x2580驱动列表"
    depends on MD_CHOICE_SOC_X2580

config MD_SOC_DIR
    string
    default soc/x2580

source package/soc/x2580/def_gpio_pins.in

source package/soc/x2580/watchdog/Config.in
source package/soc/x2580/gpio/Config.in
source package/soc/x2580/efuse/Config.in
source package/soc/x2580/i2c/Config.in
source package/soc/x2580/adc/Config.in
source package/soc/x2580/pwm/Config.in
source package/soc/x2580/mac/Config.in
source package/soc/x2580/aes/Config.in
source package/soc/x2580/rsa/Config.in
source package/soc/x2580/camera/Config.in
source package/soc/x2580/camera-double/Config.in
source package/soc/x2580/mcu_riscv/Config.in
source package/soc/x2580/utils/Config.in
source package/soc/x2580/msc/Config.in
source package/soc/x2580/spi/Config.in
source package/soc/x2580/dbox/Config.in
source package/soc/x2580/aic/Config.in
source package/soc/x2580/icodec/Config.in
source package/soc/x2580/audio_dma/Config.in
source package/soc/x2580/dmic/Config.in
source package/soc/x2580/ipu/Config.in

endmenu
```

## vendor/module_driver/package/soc/x2580/adc/Config.in
```kconfig
menuconfig MD_X2580_ADC
    bool "adc 驱动(电压采样功能)"

config MD_X2580_ADC_VREF
    int "参考电压mv"
    default 1800

endmenu
```
