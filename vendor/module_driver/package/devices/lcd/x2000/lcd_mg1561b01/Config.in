## vendor/module_driver/package/devices/wireless/fcs950uab/Config.in
```kconfig
menuconfig MD_FCS950UAB
	bool "FCS950UAB wireless cards support"

config MD_FCS950UAB_SDIO
	bool "SDIO bus interface support"
	default y

config MD_FCS950UAB_MMC_NUM
	int "wlan_mmc_num (mmc/sdio 总线号)"
	default -1
	help
	  wifi 挂接在哪个 mmc 总线,比如 0, 1

config MD_FCS950UAB_BT_WIFI_POWER
	string "gpio_bt_wifi_power(控制整个bt,wifi模块的供电)"
	default -1
	choice from SOC_GPIO_PINS

config MD_FCS950UAB_BT_WIFI_POWER_VALID_LEVEL
	string "gpio_bt_wifi_power_valid_level(bt,wifi模块供电引脚的有效电平)"
	default 0
	choice from MD_GPIO_ACTIVE_LEVEL

config MD_FCS950UAB_WLAN_REG_ON
	string "gpio_wlan_reg_on(wifi的使能引脚)"
	default -1
	choice from SOC_GPIO_PINS

config MD_FCS950UAB_WLAN_WAKE_HOST
	string "gpio_wlan_wake_host(wifi 唤醒/中断 cpu 的引脚)"
	default -1
	choice from SOC_GPIO_PINS

config MD_FCS950UAB_AP_IRQ
	string "gpio_ap_irq(wifi ap中断引脚)"
	default -1
	choice from SOC_GPIO_PINS

endmenu
```

## vendor/module_driver/package/devices/wireless/rtl8188FU_linux_v5.15.3/Config.in
```kconfig
menuconfig MD_RTL8188FU
	bool "RTL8188FU USB wireless cards support"

config MD_RTL8188FU_WLAN_POWER_ON
	string "power_on (控制wifi的供电)"
	default -1
	choice from SOC_GPIO_PINS

endmenu
```

## vendor/module_driver/package/devices/wireless/ssv6x5x_linux_v60.20/Config.in
```kconfig
menuconfig MD_SSV6X5X_V6020
    bool "SSV6X5X_V6020 wireless cards support"

array SOC_SSV6X5X_V6020_PATH
    string "固件配置文件选择"
    item "ssv6x5x-wifi.cfg" "/lib/firmware/wifi_ssv/ssv6x5x-wifi.cfg"

config MD_SSV6X5X_V6020_MMC_NUM
	int "wlan_mmc_num (mmc/sdio 总线号)"
	default -1
	help
	  wifi 挂接在哪个 mmc 总线,比如 0, 1

config MD_SSV6X5X_V6020_WIFI_POWER_EN
	string "gpio_wifi_en(控制wifi的供电)"
	default -1
	choice from SOC_GPIO_PINS

config MD_SSV6X5X_V6020_WIFI_RESET
	string "gpio_wifi_rst(控制wifi的初始上电重置)"
	default -1
	choice from SOC_GPIO_PINS

config MD_SSV6X5X_V6020_WIFI_POWER_VALID_LEVEL
	string "wifi_power_valid_level(wifi模块供电引脚的有效电平)"
	default 0
	choice from MD_GPIO_ACTIVE_LEVEL

config MD_SSV6X5X_V6020_STACFG_PATH
	string "stacfgpath"
	choice from SOC_SSV6X5X_V6020_PATH
	default "/lib/firmware/wifi_ssv/ssv6x5x-wifi.cfg"

endmenu
```

## vendor/module_driver/package/devices/wireless/wq9001/Config.in
```kconfig
menuconfig MD_WQ9001
	bool "WQ9001 usb wireless cards support"
	help
	    This module adds support for a wireless adapter based on the usb interface for WQ9001.
endmenu
```
