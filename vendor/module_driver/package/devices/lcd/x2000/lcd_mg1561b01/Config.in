## vendor/module_driver/package/devices/lcd/x2000/lcd_mg1561b01/Config.in
```kconfig
menuconfig MD_X2000_LCD_MG1561B01
    bool "TFT MG1561B01 (1920×1080) (X2000) (mipi接口)"
    select MD_X2000_FB
    depends on MD_SOC_X2000_BASE

config MD_X2000_MG1561B01_RST
    string "gpio reset(lcd 复位引脚)"
    choice from SOC_GPIO_PINS
    default -1

config MD_X2000_MG1561B01_POWER_EN
    string "gpio power enable(lcd power使能引脚)"
    choice from SOC_GPIO_PINS
    default -1

config MD_X2000_MG1561B01_POWER_VALID_LEVEL
    string "power_valid_level(供电引脚的有效电平)"
    default 0
    choice from MD_GPIO_ACTIVE_LEVEL

config MD_X2000_MG1561B01_REGULATOR_NAME
    string "regulator name(通过名字获取 lcd module 电源管理器)"
    default -1

config MD_X2000_MG1561B01_I2C_BUS_NUM
    int "i2c bus num (sensor 挂接的i2c总线号)"
    default -1

endmenu # MD_X2000_LCD_MG1561B01
```

## vendor/module_driver/package/devices/lcd/x2000/lcd_ms7024/Config.in
```kconfig
menuconfig MD_X2000_LCD_MS7024
    bool "TFT MS7024 (720x480) (X2000)"
    select MD_X2000_FB
    depends on MD_SOC_X2000_BASE

config MD_X2000_MS7024_RST
    string "gpio reset(lcd 复位引脚)"
    choice from SOC_GPIO_PINS
    default -1

config MD_X2000_MS7024_POWER_EN
    string "gpio power(lcd power使能引脚)"
    choice from SOC_GPIO_PINS
    default -1

config MD_X2000_MS7024_POWER_VALID_LEVEL
	string "power_valid_level(供电引脚的有效电平)"
	default 0
	choice from MD_GPIO_ACTIVE_LEVEL

config MD_X2000_MS7024_REGULATOR_NAME
    string "regulator name(通过名字获取 lcd module 电源管理器)"
    default -1

config MD_X2000_MS7024_I2C_BUS_NUM
	int "i2c bus num (sensor 挂接的i2c总线号)"
	default -1

endmenu # MD_X2000_LCD_MS7024
```

## vendor/module_driver/package/devices/lcd/x2000/lcd_st7703/Config.in
```kconfig
menuconfig MD_X2000_LCD_ST7703
    bool "TFT ST7703 (640 x 960) (X2000) (mipi接口)"
    select MD_X2000_FB
    depends on MD_SOC_X2000_BASE

config MD_X2000_ST7703_TE
    string "gpio TE select"
    choice from SOC_GPIO_PINS
    default -1

config MD_X2000_ST7703_RST
    string "gpio reset(lcd 复位引脚)"
    choice from SOC_GPIO_PINS
    default -1

config MD_X2000_ST7703_POWER_EN
    string "gpio power enable(lcd power 使能引脚) "
    choice from SOC_GPIO_PINS
    default -1

config MD_X2000_ST7703_REGULATOR_NAME
    string "regulator name(通过名字获取 lcd module 电源管理器)"
    default -1

config MD_X2000_ST7703_LCD_BACKLIGHT_ENABLE
    string "gpio backlight enable(lcd backlight 背光使能)"
    choice from SOC_GPIO_PINS
    default -1

endmenu # MD_X2000_LCD_ST7703
```

## vendor/module_driver/package/devices/lcd/x2600/lcd_fw050/Config.in
```kconfig
menuconfig MD_X2600_LCD_FW050
    bool "TFT FW050 (720x1280) (X2600) (mipi接口)"
    select MD_X2600_510_FB
    depends on MD_SOC_X2600_BASE

config MD_X2600_FW050_4LANE_ON
    bool "使能 4lane 通道"
    default n

config MD_X2600_FW050_BACKLIGHT_EN
    string "gpio backlight enable(lcd backlight使能引脚)"
    choice from SOC_GPIO_PINS
    default -1

config MD_X2600_FW050_RST
    string "gpio reset(lcd 复位引脚)"
    choice from SOC_GPIO_PINS
    default -1

config MD_X2600_FW050_POWER_EN
    string "gpio power(lcd power使能引脚)"
    choice from SOC_GPIO_PINS
    default -1

config MD_X2600_FW050_REGULATOR_NAME
    string "regulator name(通过名字获取 lcd module 电源管理器)"
    default -1

endmenu # MD_X2600_LCD_FW050
```

## vendor/module_driver/package/devices/lcd/x2600/lcd_fw055/Config.in
```kconfig
menuconfig MD_X2600_LCD_FW055
    bool "TFT FW055 (1080x1920) (X2600) (mipi接口)"
    select MD_X2600_510_FB
    depends on MD_SOC_X2600_BASE

config MD_X2600_FW055_BACKLIGHT_EN
    string "gpio backlight enable(lcd backlight使能引脚)"
    choice from SOC_GPIO_PINS
    default -1

config MD_X2600_FW055_RST
    string "gpio reset(lcd 复位引脚)"
    choice from SOC_GPIO_PINS
    default -1

config MD_X2600_FW055_POWER_EN
    string "gpio power(lcd power使能引脚)"
    choice from SOC_GPIO_PINS
    default -1

config MD_X2600_FW055_REGULATOR_NAME
    string "regulator name(通过名字获取 lcd module 电源管理器)"
    default -1

endmenu # MD_X2600_LCD_FW055
```

## vendor/module_driver/package/devices/lcd/x2600/lcd_gc9503v/Config.in
```kconfig
menuconfig MD_X2600_LCD_GC9503V
    bool "TFT GC9503V (480x480) (X2600)"
    select MD_X2600_510_FB
    depends on MD_SOC_X2600_BASE

config MD_X2600_GC9503V_RST
    string "gpio reset(lcd 复位引脚)"
    choice from SOC_GPIO_PINS
    default -1

config MD_X2600_GC9503V_POWER_EN
    string "gpio power enable(lcd power使能引脚)"
    choice from SOC_GPIO_PINS
    default -1

config MD_X2600_GC9503V_SPI_SCL
    string "spi clk(时钟引脚)"
    choice from SOC_GPIO_PINS
    default -1

config MD_X2600_GC9503V_SPI_SDA
    string "spi sda(mosi 输出引脚)"
    choice from SOC_GPIO_PINS
    default -1

config MD_X2600_GC9503V_SPI_CS
    string "spi cs(片选脚)"
    choice from SOC_GPIO_PINS
    default -1

endmenu # MD_X2600_LCD_GC9503V
```

## vendor/module_driver/package/devices/lcd/x2600/lcd_qm101/Config.in
```kconfig
menuconfig MD_X2600_LCD_QM101
    bool "TFT QM101 (1024 x 600) (X2600) (lvds接口)"
    select MD_X2600_510_FB
    depends on MD_SOC_X2600_BASE

config MD_X2600_QM101_POWER_EN
    string "gpio power enable(lcd power使能引脚 不设置则使用regulator) "
    choice from SOC_GPIO_PINS
    default -1

config MD_X2600_QM101_RST
    string "gpio reset(lcd 复位引脚)"
    choice from SOC_GPIO_PINS
    default -1

config MD_X2600_QM101_LCD_BACKLIGHT_ENABLE
    string "gpio backlight enable(lcd backlight背光使能)(lcd 读引脚)"
    choice from SOC_GPIO_PINS
    default -1

config MD_X2600_QM101_REGULATOR_NAME
    string "regulator name(通过名字获取 lcd module 电源管理器)"
    default -1

endmenu # MD_X2600_LCD_QM101
```

## vendor/module_driver/package/devices/lcd/x2600/lcd_slm043/Config.in
```kconfig
menuconfig MD_X2600_LCD_SLM043
    bool "TFT SLM043 (480x272) (X2600) (tft serial 8bit接口)"
    select MD_X2600_510_FB
    depends on MD_SOC_X2600_BASE

config MD_X2600_SLM043_POWER_EN
    string "gpio power enable(lcd power使能引脚)"
    choice from SOC_GPIO_PINS
    default -1

endmenu # MD_X2600_LCD_SLM043
```

## vendor/module_driver/package/devices/lcd/x2600/lcd_st7701s/Config.in
```kconfig
menuconfig MD_X2600_LCD_ST7701S
    bool "TFT ST7701S (480 x 800) (X2600) (mipi接口)"
    select MD_X2600_510_FB
    depends on MD_SOC_X2600_BASE

config MD_X2600_ST7701S_POWER_EN
    string "gpio power enable(lcd power使能引脚 不设置则使用regulator) "
    choice from SOC_GPIO_PINS
    default -1

config MD_X2600_ST7701S_RST
    string "gpio reset(lcd 复位引脚)"
    choice from SOC_GPIO_PINS
    default -1

config MD_X2600_ST7701S_LCD_BACKLIGHT_ENABLE
    string "gpio backlight enable(lcd backlight背光使能)"
    choice from SOC_GPIO_PINS
    default -1

config MD_X2600_ST7701S_REGULATOR_NAME
    string "regulator name(通过名字获取 lcd module 电源管理器)"
    default -1

endmenu # MD_X2600_LCD_ST7701S
```

## vendor/module_driver/package/devices/lcd/x2600/lcd_st7789v/Config.in
```kconfig
menuconfig MD_X2600_LCD_ST7789V
    bool "SLCD ST7789V (240x320) (X2600) (8080接口)"
    select MD_X2600_510_FB
    depends on MD_SOC_X2600_BASE

config MD_X2600_LCD_REGULATOR_NAME
    string "regulator name(通过名字获取 lcd module 电源管理器)"
    default -1

config MD_X2600_ST7789V_CS
    string "gpio chip select(lcd 片选引脚)"
    choice from SOC_GPIO_PINS
    default -1

config MD_X2600_ST7789V_RD
    string "gpio lcd read signal(lcd 读引脚)"
    choice from SOC_GPIO_PINS
    default -1

config MD_X2600_ST7789V_RST
    string "gpio reset(lcd 复位引脚)"
    choice from SOC_GPIO_PINS
    default -1

config MD_X2600_ST7789V_POWER_EN
    string "gpio power enable(lcd power使能引脚)"
    choice from SOC_GPIO_PINS
    default -1

endmenu # MD_X2600_LCD_ST7789V
```

## vendor/module_driver/package/devices/lcd/x2600/lcd_st7789v_4line_spi/Config.in
```kconfig
menuconfig MD_X2600_LCD_ST7789V_4LINE_SPI
    bool "SLCD ST7789V (240x320) (X2600) (4line_spi接口)"
    select MD_X2600_510_FB
    depends on MD_SOC_X2600_BASE


config MD_X2600_ST7789V_4LINE_SPI_CS
    string "gpio chip select(lcd 片选引脚)"
    choice from SOC_GPIO_PINS
    default -1

config MD_X2600_ST7789V_4LINE_SPI_RST
    string "gpio reset(lcd 复位引脚)"
    choice from SOC_GPIO_PINS
    default -1

config MD_X2600_ST7789V_4LINE_SPI_POWER_EN
    string "gpio power enable(lcd power使能引脚)"
    choice from SOC_GPIO_PINS
    default -1

endmenu # MD_X2600_LCD_ST7789V_4LINE_SPI
```

## vendor/module_driver/package/devices/lcd/x2600/lcd_tf450/Config.in
```kconfig
menuconfig MD_X2600_LCD_TF450
    bool "TFT TF450 (480 x 854) (X2600) (mipi接口)"
    select MD_X2600_510_FB
    depends on MD_SOC_X2600_BASE

config MD_X2600_TF450_POWER_EN
    string "gpio power enable(lcd power使能引脚 不设置则使用regulator) "
    choice from SOC_GPIO_PINS
    default -1

config MD_X2600_TF450_RST
    string "gpio reset(lcd 复位引脚)"
    choice from SOC_GPIO_PINS
    default -1

config MD_X2600_TF450_LCD_BACKLIGHT_ENABLE
    string "gpio backlight enable(lcd backlight背光使能)"
    choice from SOC_GPIO_PINS
    default -1

config MD_X2600_TF450_REGULATOR_NAME
    string "regulator name(通过名字获取 lcd module 电源管理器)"
    default -1

endmenu # MD_X2600_LCD_TF450
```

## vendor/module_driver/package/devices/lcd/x2600/lcd_yc101/Config.in
```kconfig
menuconfig MD_X2600_LCD_YC101
    bool "TFT YC101 (800x1280) (X2600) (mipi接口)"
    select MD_X2600_510_FB
    depends on MD_SOC_X2600_BASE

config MD_X2600_YC101_4LANE_ON
    bool "使能 4lane 通道"
    default n

config MD_X2600_YC101_RST
    string "gpio reset(lcd 复位引脚)"
    choice from SOC_GPIO_PINS
    default -1

config MD_X2600_YC101_POWER_EN
    string "gpio power(lcd power使能引脚)"
    choice from SOC_GPIO_PINS
    default -1

config MD_X2600_YC101_REGULATOR_NAME
    string "regulator name(通过名字获取 lcd module 电源管理器)"
    default -1

endmenu # MD_X2600_LCD_YC101
```

## vendor/module_driver/package/devices/pmu/Config.in
```kconfig
menu "电源管理设备列表"
source /package/devices/pmu/axp-216/Config.in
source /package/devices/pmu/eta6919/Config.in
endmenu
```

## vendor/module_driver/package/devices/pmu/eta6919/Config.in
```kconfig
array MD_PMU_ETA6919_MODE_LIST
    int "pmu 上电模式列表"
    item "USB供电" 0
    item "USB供电,电池充电" 1
    item "电池供电" 2

menuconfig MD_PMU_ETA6919_POWER
    bool "ETA6919"

config MD_PMU_ETA6919_INT_GPIO
    string "pmu interrupt gpio(eta6919 中断脚)"
    choice from SOC_GPIO_PINS
    default -1

config MD_PMU_ETA6919_I2C_BUSNUM
    int "pmu i2c bus num (eta6919 挂接的i2c总线号)"
    default -1

config MD_PMU_ETA6919_MODE
    int "pmu 上电模式"
    default 0
    choice from MD_PMU_ETA6919_MODE_LIST

config MD_PMU_ETA6919_CHARGE_CURRENT
    int "pmu charge current (充电电流, 单位：mA)"
    default 800

config MD_PMU_ETA6919_CHARGE_VOLTAGE
    int "pmu charge voltage (充电电压, 单位：mV)"
    default 4200

config MD_PMU_ETA6919_CHARGE_PRE_CURRENT
    int "pmu pre-charge current (预充电电流, 单位：mA)"
    default 40

config MD_PMU_ETA6919_CHARGE_TERM_CURRENT
    int "pmu term charge current (截止充电电流, 单位：mA)"
    default 60

config MD_PMU_ETA6919_INPUT_CURRENT
    int "pmu input current (输入电流, 单位：mA)"
    default 2400

config MD_PMU_ETA6919_INPUT_VOLTAGE
    int "pmu input voltage (输入电压, 单位：mV)"
    default 4500

endmenu
```

## vendor/module_driver/package/devices/touchscreen/cst8xx_touch/Config.in
```kconfig
menuconfig MD_TOUCHSCREEN_CST8XX
    bool "ts_cst8xx"

config MD_CST8_I2C_BUSNUM
    int "i2c bus num(触摸屏挂接的i2c总线号)"
    default -1

config MD_CST8_REGULATOR_NAME
    string "regulator name(通过名字获取 tp module 电源管理器)"
    default -1

config MD_CST8_I2C_POWER_ENABLE_LEVEL
    string "gpio active level (tp power 使能电平)"
    choice from MD_GPIO_ACTIVE_LEVEL
    default 1

config MD_CST8_I2C_POWER_ENABLE_GPIO
    string "gpio power enable(tp power 使能引脚)"
    choice from SOC_GPIO_PINS
    default -1

config MD_CST8_RESET_GPIO
    string "gpio reset(touchscreen 复位脚)"
    choice from SOC_GPIO_PINS

config MD_CST8_IRQ_GPIO
    string "gpio irq(touchscreen 中断引脚)"
    choice from SOC_GPIO_PINS

config MD_CST8_X_COORDS_MIN
    int "最小X轴坐标值"
    default 0

config MD_CST8_Y_COORDS_MIN
    int "最小Y轴坐标值"
    default 0

config MD_CST8_X_COORDS_MAX
    int "最大X轴坐标值"
    default 170

config MD_CST8_Y_COORDS_MAX
    int "最大Y轴坐标值"
    default 320

config MD_CST8_X_COORDS_FLIP
    bool "X轴是否翻转"
    default n

config MD_CST8_Y_COORDS_FLIP
    bool "Y轴是否翻转"
    default n

config MD_CST8_X_Y_COORDS_EXCHANGE
    bool "X,Y轴是否对调"
    default n

config MD_CST8_MAX_TOUCH_NUMBER
    int "能检测的最大触摸点个数(目前暂时仅支持单点触摸)"
    default 1

endmenu
```

## vendor/module_driver/package/devices/wireless/Config.in
```kconfig
menu "bt,wifi...无线设备"

source package/devices/wireless/aic8800_usb/Config.in

source package/devices/wireless/aic8800D80/Config.in

source package/devices/wireless/atbm603x_linux/Config.in

source package/devices/wireless/bcmdhd/Config.in

source package/devices/wireless/bcmdhd_1.363.59.144/Config.in

source package/devices/wireless/bcmdhd_1.363.125.7/Config.in

source package/devices/wireless/bcmdhd_1.363.125.19_infineon/Config.in

source package/devices/wireless/esp32_linux/Config.in

source package/devices/wireless/esp8089_linux/Config.in

source package/devices/wireless/fcs950uab/Config.in

source package/devices/wireless/hi3861v032_linux/Config.in

source package/devices/wireless/rtl8188FU_linux_v5.15.3/Config.in

source package/devices/wireless/rtl8189FS_linux_v5.7.10/Config.in

source package/devices/wireless/rtl8723DS_WiFi_linux_v5.10/Config.in

source package/devices/wireless/rtl8733BS_WiFi_linux_v5.10/Config.in

source package/devices/wireless/rtl8821CS_WiFi_linux/Config.in

source package/devices/wireless/rtl8822CS_WiFi_linux/Config.in

source package/devices/wireless/ssv6x5x_linux/Config.in

source package/devices/wireless/ssv6x5x_linux_v60.20/Config.in

source package/devices/wireless/wq9001/Config.in

endmenu
```

## vendor/module_driver/package/devices/wireless/aic8800D80/Config.in
```kconfig
menuconfig MD_AIC8800D80
	bool "AIC8800D80 wireless cards support"

config MD_AIC8800D80_SDIO
	bool "SDIO bus interface support"
	default y

config MD_AIC8800D80_MMC_NUM
	int "wlan_mmc_num (mmc/sdio 总线号)"
	default -1
	help
	  wifi 挂接在哪个 mmc 总线,比如 0, 1

config MD_AIC8800D80_WLAN_REG_ON
	string "gpio_wlan_reg_on(wifi的使能引脚)"
	default -1
	choice from SOC_GPIO_PINS

config MD_AIC8800D80_WLAN_WAKE_HOST
	string "gpio_wlan_wake_host(wifi 唤醒/中断 cpu 的引脚)"
	default -1
	choice from SOC_GPIO_PINS


endmenu
```

## vendor/module_driver/package/devices/wireless/aic8800_usb/Config.in
```kconfig
menuconfig MD_AIC8800_USB
	bool "AIC8800_USB wireless cards support"

config MD_AIC8800_USB_WLAN_POWER
	string "gpio_wlan_power(wifi的供电引脚)"
	default -1
	choice from SOC_GPIO_PINS

config MD_AIC8800_USB_WLAN_REG_ON
	string "gpio_wlan_reg_on(wifi的使能引脚)"
	default -1
	choice from SOC_GPIO_PINS

endmenu
```

## vendor/module_driver/package/devices/wireless/atbm603x_linux/Config.in
```kconfig
menuconfig MD_ATBM603X
	bool "ATBM603X wireless cards support"

config MD_ATBM603X_SDIO
	bool "SDIO bus interface support"
	default y

config MD_ATBM603X_MMC_NUM
	int "wlan_mmc_num (mmc/sdio 总线号)"
	default -1
	help
	  wifi 挂接在哪个 mmc 总线,比如 0, 1

config MD_ATBM603X_WLAN_REG_ON
	string "gpio_wlan_reg_on(wifi的使能引脚)"
	default -1
	choice from SOC_GPIO_PINS

config MD_ATBM603X_WLAN_WAKE_HOST
	string "gpio_wlan_wake_host(wifi 唤醒/中断 cpu 的引脚)"
	default -1
	choice from SOC_GPIO_PINS


endmenu
```

## vendor/module_driver/package/devices/wireless/esp32_linux/Config.in
```kconfig
menuconfig MD_ESP32
    bool "ESP32 wireless cards support"

config MD_ESP32_MMC_NUM
    int "wlan_mmc_num (mmc/sdio 总线号)"
    default -1
    help
      wifi 挂接在哪个 mmc 总线,比如 0, 1

config MD_ESP32_POWER_EN
    string "gpio_power_en(wifi的供电引脚)"
    default -1
    choice from SOC_GPIO_PINS

config MD_ESP32_WIFI_POWER_VALID_LEVEL
	string "wifi_power_valid_level(wifi模块供电引脚的有效电平)"
	default 0
	choice from MD_GPIO_ACTIVE_LEVEL

config MD_ESP32_WLAN_REG_ON
    string "gpio_wlan_reg_on(wifi的使能引脚)"
    default -1
    choice from SOC_GPIO_PINS

config MD_ESP32_DOWNLOAD_MODE
    string "gpio_download_mode(wifi的系统下载模式设置)"
    default -1
    choice from SOC_GPIO_PINS

endmenu
```
