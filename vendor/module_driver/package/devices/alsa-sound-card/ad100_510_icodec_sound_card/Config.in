## vendor/module_driver/package/devices/lcd/ad100/lcd_st7797/Config.in
```kconfig
menuconfig MD_AD100_LCD_ST7797
    bool "TFT ST7797 (400x400) (AD100) (mipi接口)"
    select MD_AD100_510_FB
    depends on MD_SOC_AD100_BASE

config MD_AD100_ST7797_BACKLIGHT_EN
    string "gpio backlight enable(lcd backlight使能引脚)"
    choice from SOC_GPIO_PINS
    default -1

config MD_AD100_ST7797_RST
    string "gpio reset(lcd 复位引脚)"
    choice from SOC_GPIO_PINS
    default -1

config MD_AD100_ST7797_POWER_EN
    string "gpio power(lcd power使能引脚)"
    choice from SOC_GPIO_PINS
    default -1

config MD_AD100_ST7797_REGULATOR_NAME
    string "regulator name(通过名字获取 lcd module 电源管理器)"
    default -1

endmenu # MD_AD100_LCD_ST7797
```

## vendor/module_driver/package/devices/lcd/ad100/lcd_yc101/Config.in
```kconfig
menuconfig MD_AD100_LCD_YC101
    bool "TFT YC101 (800x1280) (AD100) (mipi接口)"
    select MD_AD100_510_FB
    depends on MD_SOC_AD100_BASE

config MD_AD100_YC101_RST
    string "gpio reset(lcd 复位引脚)"
    choice from SOC_GPIO_PINS
    default -1

config MD_AD100_YC101_POWER_EN
    string "gpio power(lcd power使能引脚)"
    choice from SOC_GPIO_PINS
    default -1

config MD_AD100_YC101_REGULATOR_NAME
    string "regulator name(通过名字获取 lcd module 电源管理器)"
    default -1

endmenu # MD_AD100_LCD_YC101
```

## vendor/module_driver/package/devices/lcd/x1600/lcd_st7789_4line_spi/Config.in
```kconfig
menuconfig MD_X1600_LCD_ST7789_4LINE_SPI
    bool "SLCD ST7789 4LINE_SPI(240*320) (X1600)"
    select MD_X1600_FB
    depends on MD_SOC_X1600_BASE

config MD_X1600_ST7789_4LINE_SPI_CS
    string "gpio chip select(lcd 片选引脚)"
    choice from SOC_GPIO_PINS
    default -1

config MD_X1600_ST7789_4LINE_SPI_RST
    string "gpio reset(lcd 复位引脚)"
    choice from SOC_GPIO_PINS
    default -1

config MD_X1600_ST7789_4LINE_SPI_POWER_EN
    string "gpio power enable(lcd power使能引脚)"
    choice from SOC_GPIO_PINS
    default -1

endmenu # MD_X1600_LCD_ST7789_4LINE_SPI
```

## vendor/module_driver/package/devices/lcd/x2000/lcd_gm8285c/Config.in
```kconfig
menuconfig MD_X2000_LCD_GM8285C
    bool "TFT GM8285C (1024x768) (X2000)"
    select MD_X2000_FB
    depends on MD_SOC_X2000_BASE

config MD_X2000_GM8285C_RST
    string "gpio reset(lcd 复位引脚)"
    choice from SOC_GPIO_PINS
    default -1

config MD_X2000_GM8285C_POWER_EN
    string "gpio power(lcd power使能引脚)"
    choice from SOC_GPIO_PINS
    default -1

config MD_X2000_GM8285C_POWER_VALID_LEVEL
	string "power_valid_level(供电引脚的有效电平)"
	default 0
	choice from MD_GPIO_ACTIVE_LEVEL

endmenu # MD_X2000_LCD_GM8285C
```
