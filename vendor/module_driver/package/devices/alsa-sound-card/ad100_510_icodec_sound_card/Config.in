## vendor/module_driver/package/devices/alsa-sound-card/ad100_510_icodec_sound_card/Config.in
```kconfig
config MD_AD100_510_ICODEC_SOUND_CARD
    bool "使用 ad100_510 icodec(内部codec) 创建一个声卡"
```

## vendor/module_driver/package/devices/alsa-sound-card/x2000_dummy_sound_card/Config.in
```kconfig
config  MD_X2000_DUMMY_SOUND_CARD
    bool "使用 X2000 创建一个虚拟外部声卡(用户没有外部声卡驱动时可以用虚拟声卡输出i2s信号)"
```

## vendor/module_driver/package/devices/alsa-sound-card/x2600_510_dummy_sound_card/Config.in
```kconfig
config MD_X2600_510_DUMMY_SOUND_CARD
    bool "使用 x2600 510 创建一个虚拟外部声卡(用户没有外部声卡驱动时可以用虚拟声卡输出i2s信号)"
```

## vendor/module_driver/package/devices/alsa-sound-card/x2600_510_icodec_sound_card/Config.in
```kconfig
config MD_X2600_510_ICODEC_SOUND_CARD
    bool "使用 x2600_510 icodec(内部codec) 创建一个声卡"
```

## vendor/module_driver/package/devices/camera/x2000/ov9282_mipi/Config.in
```kconfig
menuconfig MD_X2000_SENSOR_OV9282_MIPI
    bool "sensor ov9282 (mipi,raw8)"
    select MD_X2000_CAMERA_VIC
    depends on MD_SOC_X2000_BASE

source package/soc/x2000/camera/interface_type.in

config MD_X2000_OV9282_CAMERA_INDEX
    string "选择控制器(sensor 连接soc控制器接口索引)"
    choice from CAMERA_INTERFACE_TYPE_SELECT
    default -1

config MD_X2000_OV9282_GPIO_RESET
    string "gpio reset(sensor 复位脚)"
    choice from SOC_GPIO_PINS
    default -1

config MD_X2000_OV9282_GPIO_PWDN
    string "gpio pwdn(sensor 电源控制引脚, 低有效)"
    choice from SOC_GPIO_PINS
    default -1

config MD_X2000_OV9282_GPIO_POWER
    string "gpio power(sensor 电源控制引脚, 高有效)"
    choice from SOC_GPIO_PINS
    default -1

config MD_X2000_OV9282_I2C_BUSNUM
    int "i2c bus num (sensor 挂接的i2c总线号)"
    default -1

array SENSOR_RESOLUTION
    string "sensor resolution"
    item "1280*800 120fps" OV9282_1280_800_120FPS
    item "1280*800 60fps"  OV9282_1280_800_60FPS

config MD_X2000_OV9282_MIPI_RESOLUTION
    string "resolution(ov9282分辨率配置)"
    choice from SENSOR_RESOLUTION
    default OV9282_1280_800_120FPS

endmenu # MD_X2000_SENSOR_OV9282_MIPI
```

## vendor/module_driver/package/devices/camera/x2580/ar0234_mipi/Config.in
```kconfig
menuconfig MD_X2580_SENSOR_AR0234_MIPI
    bool "sensor ar0234 (mipi,raw8)"
    select MD_X2580_CAMERA_VIC_DOUBLE
    depends on MD_SOC_X2580_BASE

menuconfig MD_X2580_SENSOR0_AR0234
    bool "sensor0 config"

config MD_X2580_AR0234_SENSOR0_NAME
    string "sensor module name"
    default "ar0234-0"

config MD_X2580_AR0234_GPIO_RESET0
    string "gpio reset(sensor 复位脚)"
    choice from SOC_GPIO_PINS
    default -1

config MD_X2580_AR0234_GPIO_POWER0
    string "gpio power(sensor 电源控制引脚, 高有效)"
    choice from SOC_GPIO_PINS
    default -1

config MD_X2580_AR0234_REGULATOR_NAME0
    string "regulator name(通过名字获取 sensor module 电源管理器)"
    default "GPIO-POWER0"

config MD_X2580_AR0234_I2C_BUSNUM0
    int "i2c bus num (sensor 挂接的i2c总线号)"
    default -1

config MD_X2580_AR0234_I2C_ADDR0
    int "i2c device addr (sensor的i2c地址)"
    default 0x10
endmenu # MD_X2580_SENSOR0_AR0234


menuconfig MD_X2580_SENSOR1_AR0234
    bool "sensor1 config"
    select MD_X2580_SENSOR0_AR0234

config MD_X2580_AR0234_SENSOR1_NAME
    string "sensor module name"
    default "ar0234-1"

config MD_X2580_AR0234_GPIO_RESET1
    string "gpio reset(sensor 复位脚)"
    choice from SOC_GPIO_PINS
    default -1

config MD_X2580_AR0234_GPIO_POWER1
    string "gpio power(sensor 电源控制引脚, 高有效)"
    choice from SOC_GPIO_PINS
    default -1

config MD_X2580_AR0234_REGULATOR_NAME1
    string "regulator name(通过名字获取 sensor module 电源管理器)"
    default "GPIO-POWER0"

config MD_X2580_AR0234_I2C_BUSNUM1
    int "i2c bus num (sensor 挂接的i2c总线号)"
    default -1

config MD_X2580_AR0234_I2C_ADDR1
    int "i2c device addr (sensor的i2c地址)"
    default 0x18
endmenu # MD_X2580_SENSOR1_AR0234

endmenu # MD_X2580_SENSOR_AR0234_MIPI
```

## vendor/module_driver/package/devices/camera/x2580/gc4663_mipi/Config.in
```kconfig
menuconfig MD_X2580_SENSOR_GC4663_MIPI
    bool "sensor gc4663 (mipi,raw10)"
    select MD_X2580_CAMERA_VIC
    depends on MD_SOC_X2580_BASE

config MD_X2580_GC4663_GPIO_RESET
    string "gpio reset(sensor 复位脚)"
    choice from SOC_GPIO_PINS
    default -1

config MD_X2580_GC4663_GPIO_PWDN
    string "gpio pwdn(sensor 使能引脚, 低有效)"
    choice from SOC_GPIO_PINS
    default -1

config MD_X2580_GC4663_GPIO_POWER
    string "gpio power(sensor 电源控制引脚, 高有效)"
    choice from SOC_GPIO_PINS
    default -1

config MD_X2580_GC4663_I2C_BUSNUM
    int "i2c bus num (sensor 挂接的i2c总线号)"
    default -1

endmenu # MD_X2580_SENSOR_GC4663_MIPI
```

## vendor/module_driver/package/devices/camera/x2580/og02b10_mipi/Config.in
```kconfig
menuconfig MD_X2580_SENSOR_OG02B10_MIPI
    bool "sensor og02b10 (mipi,raw10)"
    select MD_X2580_CAMERA_VIC
    depends on MD_SOC_X2580_BASE

config MD_X2580_OG02B10_SENSOR_NAME
    string "sensor module name"
    default "og02b10"

config MD_X2580_OG02B10_GPIO_PWDN
    string "gpio pwdn(sensor 使能引脚, 低有效)"
    choice from SOC_GPIO_PINS
    default -1

config MD_X2580_OG02B10_GPIO_POWER
    string "gpio power(sensor 电源控制引脚, 高有效)"
    choice from SOC_GPIO_PINS
    default -1

config MD_X2580_OG02B10_I2C_BUSNUM
    int "i2c bus num (sensor 挂接的i2c总线号)"
    default -1

config MD_X2580_OG02B10_I2C_ADDR
    int "i2c device addr (sensor的i2c地址)"
    default -1

config MD_X2580_OG02B10_CAM_BUSNUM
    int "cam bus num (sensor 挂接的vic/cim总线号)"
    default -1

endmenu # MD_X2580_SENSOR_OG02B10_MIPI
```

## vendor/module_driver/package/devices/camera/x2580/ov9282_mipi/Config.in
```kconfig
menuconfig MD_X2580_SENSOR_OV9282_MIPI
    bool "sensor ov9282 (mipi,raw8)"
    select MD_X2580_CAMERA_VIC
    depends on MD_SOC_X2580_BASE

config MD_X2580_OV9282_GPIO_RESET
    string "gpio reset(sensor 复位脚)"
    choice from SOC_GPIO_PINS
    default -1

config MD_X2580_OV9282_GPIO_PWDN
    string "gpio pwdn(sensor 电源控制引脚, 低有效)"
    choice from SOC_GPIO_PINS
    default -1

config MD_X2580_OV9282_GPIO_POWER
    string "gpio power(sensor 电源控制引脚, 高有效)"
    choice from SOC_GPIO_PINS
    default -1

config MD_X2580_OV9282_I2C_BUSNUM
    int "i2c bus num (sensor 挂接的i2c总线号)"
    default -1

array SENSOR_RESOLUTION
    string "sensor resolution"
    item "1280*800 120fps" OV9282_1280_800_120FPS
    item "1280*800 60fps"  OV9282_1280_800_60FPS

config MD_X2580_OV9282_MIPI_RESOLUTION
    string "resolution(ov9282分辨率配置)"
    choice from SENSOR_RESOLUTION
    default OV9282_1280_800_120FPS

endmenu # MD_X2580_SENSOR_OV9282_MIPI
```

## vendor/module_driver/package/devices/camera/x2580/sc132_mipi/Config.in
```kconfig
menuconfig MD_X2580_SENSOR_SC132_MIPI
    bool "sensor sc132 (mipi,raw8)"
    select MD_X2580_CAMERA_VIC
    depends on MD_SOC_X2580_BASE

config MD_X2580_SC132_GPIO_RESET
    string "gpio reset(sensor 复位脚)"
    choice from SOC_GPIO_PINS
    default -1

config MD_X2580_SC132_GPIO_PWDN
    string "gpio pwdn(sensor 电源控制引脚, 低有效)"
    choice from SOC_GPIO_PINS
    default -1

config MD_X2580_SC132_GPIO_POWER
    string "gpio power(sensor 电源控制引脚, 高有效)"
    choice from SOC_GPIO_PINS
    default -1

config MD_X2580_SC132_I2C_BUSNUM
    int "i2c bus num (sensor 挂接的i2c总线号)"
    default -1

endmenu # MD_X2580_SENSOR_SC132_MIPI
```

## vendor/module_driver/package/devices/camera/x2600/sc031_dvp/Config.in
```kconfig
menuconfig MD_X2600_SENSOR_SC031_DVP
    bool "sensor sc031 (dvp,raw8)"
    select MD_X2600_510_CAMERA
    depends on MD_SOC_X2600_BASE

config MD_X2600_SC031_DVP_GPIO_RESET
    string "gpio reset(sensor 复位脚)"
    choice from SOC_GPIO_PINS
    default -1

config MD_X2600_SC031_DVP_GPIO_PWDN
    string "gpio pwdn(sensor 电源控制引脚, 低有效)"
    choice from SOC_GPIO_PINS
    default -1

config MD_X2600_SC031_DVP_GPIO_POWER
    string "gpio power(sensor 电源控制引脚, 高有效)"
    choice from SOC_GPIO_PINS
    default -1

config MD_X2600_SC031_DVP_I2C_BUSNUM
    int "i2c bus num (sensor 挂接的i2c总线号)"
    default -1

endmenu
```

## vendor/module_driver/package/devices/keyboard/Config.in
```kconfig
menu "按键设备列表"

source package/devices/keyboard/keyboard_gpio/Config.in
source package/devices/keyboard/keyboard_adc/Config.in
source package/devices/keyboard/keyboard_mult_adc/Config.in
source package/devices/keyboard/keyboard_matrix/Config.in

endmenu
```

## vendor/module_driver/package/devices/keyboard/keyboard_mult_adc/Config.in
```kconfig
menuconfig MD_KEYBOARD_MULT_ADC
    bool "多通道ADC按键驱动"

config MD_MULT_ADC_KEY_DEBUG
    bool "开启多通道ADC按鍵DEBUG打印"
    default n

source package/devices/keyboard/keyboard_mult_adc/keyboard_adc0.in
source package/devices/keyboard/keyboard_mult_adc/keyboard_adc1.in
source package/devices/keyboard/keyboard_mult_adc/keyboard_adc2.in
source package/devices/keyboard/keyboard_mult_adc/keyboard_adc3.in

endmenu # MD_KEYBOARD_MULT_ADC
```

## vendor/module_driver/package/devices/lcd/Config.in
```kconfig
menu "lcd设备列表"

source package/devices/lcd/x1830/lcd_kwh035/Config.in
source package/devices/lcd/x1830/lcd_st7701/Config.in
source package/devices/lcd/x1830/lcd_st7701_9bit_spi/Config.in
source package/devices/lcd/x1000/lcd_truly240240/Config.in
source package/devices/lcd/x1021/lcd_kwh035/Config.in
source package/devices/lcd/x2000/lcd_kwh035/Config.in
source package/devices/lcd/x2000/lcd_kd070d57/Config.in
source package/devices/lcd/x2000/lcd_fw050/Config.in
source package/devices/lcd/x2000/lcd_ma0060/Config.in
source package/devices/lcd/x2000/lcd_m1700/Config.in
source package/devices/lcd/x2000/lcd_st7789/Config.in
source package/devices/lcd/x2000/lcd_st7701s/Config.in
source package/devices/lcd/x2000/lcd_jd9851/Config.in
source package/devices/lcd/x2000/lcd_s6d04d1/Config.in
source package/devices/lcd/x2000/lcd_cc0702/Config.in
source package/devices/lcd/x2000/lcd_gc9106/Config.in
source package/devices/lcd/spi/lcd_gc9106/Config.in
source package/devices/lcd/x2000/lcd_jd9366/Config.in
source package/devices/lcd/x2000/lcd_gl0700/Config.in
source package/devices/lcd/x2000/lcd_ili9881d/Config.in
source package/devices/lcd/x2000/lcd_otm8018b/Config.in
source package/devices/lcd/x2000/lcd_st7785m/Config.in
source package/devices/lcd/x2000/lcd_ms7024/Config.in
source package/devices/lcd/x2000/lcd_st7703/Config.in
source package/devices/lcd/x2000/lcd_mg1561b01/Config.in
source package/devices/lcd/x2000/lcd_gm8285c/Config.in

source package/devices/lcd/x1600/lcd_st7789_4line_spi/Config.in
source package/devices/lcd/x1600/lcd_st7701/Config.in
source package/devices/lcd/x1600/lcd_kwh035/Config.in

source package/devices/lcd/x2600/lcd_fw050/Config.in
source package/devices/lcd/x2600/lcd_fw055/Config.in
source package/devices/lcd/x2600/lcd_st7701s/Config.in
source package/devices/lcd/x2600/lcd_st7701s_tft/Config.in
source package/devices/lcd/x2600/lcd_st7789v/Config.in
source package/devices/lcd/x2600/lcd_st7789v_4line_spi/Config.in
source package/devices/lcd/x2600/lcd_kx070/Config.in
source package/devices/lcd/x2600/lcd_slm043/Config.in
source package/devices/lcd/x2600/lcd_tf450/Config.in
source package/devices/lcd/x2600/lcd_qm101/Config.in
source package/devices/lcd/x2600/lcd_gc9503v/Config.in
source package/devices/lcd/x2600/lcd_jlt7003a/Config.in
source package/devices/lcd/x2600/lcd_ck450/Config.in
source package/devices/lcd/x2600/lcd_yc101/Config.in

source package/devices/lcd/ad100/lcd_fw050/Config.in
source package/devices/lcd/ad100/lcd_qm047ks01/Config.in
source package/devices/lcd/ad100/lcd_ld047rf1l01/Config.in
source package/devices/lcd/ad100/lcd_qm047ks02/Config.in
source package/devices/lcd/ad100/lcd_st7283/Config.in
source package/devices/lcd/ad100/lcd_st7701s_frd450/Config.in
source package/devices/lcd/ad100/lcd_st7797/Config.in
source package/devices/lcd/ad100/lcd_yc101/Config.in

endmenu
```

## vendor/module_driver/package/devices/lcd/ad100/lcd_fw050/Config.in
```kconfig
menuconfig MD_AD100_LCD_FW050
    bool "TFT FW050 (720x1280) (AD100) (mipi接口)"
    select MD_AD100_510_FB
    depends on MD_SOC_AD100_BASE

config MD_AD100_FW050_4LANE_ON
    bool "使能 4lane 通道"
    default n

config MD_AD100_FW050_BACKLIGHT_EN
    string "gpio backlight enable(lcd backlight使能引脚)"
    choice from SOC_GPIO_PINS
    default -1

config MD_AD100_FW050_RST
    string "gpio reset(lcd 复位引脚)"
    choice from SOC_GPIO_PINS
    default -1

config MD_AD100_FW050_POWER_EN
    string "gpio power(lcd power使能引脚)"
    choice from SOC_GPIO_PINS
    default -1

config MD_AD100_FW050_REGULATOR_NAME
    string "regulator name(通过名字获取 lcd module 电源管理器)"
    default -1

endmenu # MD_AD100_LCD_FW050
```

## vendor/module_driver/package/devices/lcd/ad100/lcd_ld047rf1l01/Config.in
```kconfig
menuconfig MD_AD100_LCD_LD047RF1L01
    bool "TFT LD047RF1L01 (750x1334) (AD100) (mipi接口)"
    select MD_AD100_510_FB
    depends on MD_SOC_AD100_BASE

config MD_AD100_LD047RF1L01_BACKLIGHT_EN
    string "gpio backlight enable(lcd backlight使能引脚)"
    choice from SOC_GPIO_PINS
    default -1

config MD_AD100_LD047RF1L01_RST
    string "gpio reset(lcd 复位引脚)"
    choice from SOC_GPIO_PINS
    default -1

config MD_AD100_LD047RF1L01_POWER_EN
    string "gpio power(lcd power使能引脚)"
    choice from SOC_GPIO_PINS
    default -1

config MD_AD100_LD047RF1L01_REGULATOR_NAME
    string "regulator name(通过名字获取 lcd module 电源管理器)"
    default -1

endmenu # MD_AD100_LCD_LD047RF1L01
```

## vendor/module_driver/package/devices/lcd/ad100/lcd_qm047ks01/Config.in
```kconfig
menuconfig MD_AD100_LCD_QM047KS01
    bool "TFT QM047KS01 (750x1334) (AD100) (mipi接口)"
    select MD_AD100_510_FB
    depends on MD_SOC_AD100_BASE

config MD_AD100_QM047KS01_BACKLIGHT_EN
    string "gpio backlight enable(lcd backlight使能引脚)"
    choice from SOC_GPIO_PINS
    default -1

config MD_AD100_QM047KS01_RST
    string "gpio reset(lcd 复位引脚)"
    choice from SOC_GPIO_PINS
    default -1

config MD_AD100_QM047KS01_POWER_EN
    string "gpio power(lcd power使能引脚)"
    choice from SOC_GPIO_PINS
    default -1

config MD_AD100_QM047KS01_REGULATOR_NAME
    string "regulator name(通过名字获取 lcd module 电源管理器)"
    default -1

endmenu # MD_AD100_LCD_QM047KS01
```

## vendor/module_driver/package/devices/lcd/ad100/lcd_st7283/Config.in
```kconfig
menuconfig MD_AD100_LCD_ST7283
    bool "TFT ST7283 (480x272) (AD100) (tft 8bit serial接口)"
    select MD_AD100_510_FB
    depends on MD_SOC_AD100_BASE

config MD_AD100_ST7283_POWER_EN
    string "gpio power enable(lcd power使能引脚)"
    choice from SOC_GPIO_PINS
    default -1

config MD_AD100_ST7283_DISPLAY_EN
    string "gpio display enable(lcd display使能引脚)"
    choice from SOC_GPIO_PINS
    default -1

config MD_AD100_ST7283_BACKLIGHT_EN
    string "gpio backlight enable(lcd backlight背光使能)"
    choice from SOC_GPIO_PINS
    default -1

endmenu # MD_AD100_LCD_ST7283
```

## vendor/module_driver/package/devices/lcd/ad100/lcd_st7701s_frd450/Config.in
```kconfig
menuconfig MD_AD100_LCD_ST7701S_FRD450
    bool "TFT ST7701S_FRD450 (480x854) (AD100) (mipi接口)"
    select MD_AD100_510_FB
    depends on MD_SOC_AD100_BASE

config MD_AD100_ST7701S_FRD450_BACKLIGHT_EN
    string "gpio backlight enable(lcd backlight使能引脚)"
    choice from SOC_GPIO_PINS
    default -1

config MD_AD100_ST7701S_FRD450_RST
    string "gpio reset(lcd 复位引脚)"
    choice from SOC_GPIO_PINS
    default -1

config MD_AD100_ST7701S_FRD450_POWER_EN
    string "gpio power(lcd power使能引脚)"
    choice from SOC_GPIO_PINS
    default -1

config MD_AD100_ST7701S_FRD450_REGULATOR_NAME
    string "regulator name(通过名字获取 lcd module 电源管理器)"
    default -1

endmenu # MD_AD100_LCD_ST7701S_FRD450
```
