## vendor/module_driver/package/soc/x2600_510/icodec/Config.in
```kconfig
menuconfig MD_X2600_510_ICODEC
    bool "icodec(内部codec)"
    select MD_X2600_510_AIC

config MD_X2600_510_ICODEC_BAIS_ON
    bool "开启偏置电压"
    default y
    help
        对于外接的模拟电路,内部codec需要提前打开偏置电压

config MD_X2600_510_ICODEC_BAIS_LEVEL
    int "偏置电压的寄存器数值(范围[0,7])"
    default 7
    help
        其中0代表1.6*VREF(VREF=AVDD/2),7代表1.95*VREF
        每增加1,增加0.05*VREF
        当启用回采电路一般置为0

config MD_X2600_510_ICODEC_MIC_IN_GAIN
    int "mic信号的增益(可填0,1,2,3)"
    default 3
    help
        范围为0,1,2,3 对应0,6,20,30db
        当启用回采电路一般置为0

config MX_X2600_510_ICODEC_MENUAL_ALCL_GAIN
    int "手动设置ALCL增益(范围[0,31])"
    default 6
    help
        其中0代表-9db,6代表0db,31代表37.5db
        增加1,音量增加1.5dB

config MX_X2600_510_ICODEC_HPL_GAIN
    int "输出信号的增益 HPOUTL(范围[26,31])"
    default 26
    help
        其中0-25无效,26代表0db,30与31代表6db
        增加1,音量增加1.5db，上限为6db

config MD_X2600_510_ICODEC_SPK_GPIO
    string "功放引脚"
    choice from SOC_GPIO_PINS
    default -1

config MD_X2600_510_ICODEC_SPK_GPIO_LEVEL
    string "功放引脚使能电平"
    choice from MD_GPIO_ACTIVE_LEVEL
    default 1

config MD_X2600_510_ICODEC_SPK_NEED_DELAY_MS
    int "功放引脚使能后需要的延时时间(ms)"
    default 20
    help
        部分功放芯片的时序需要在使能功放引脚后加一定的延时

config MD_X2600_510_ICODEC_MAX_DAC_VAL
    int "外放音量最大值(对应寄存器DACDGR的[0,7],可填范围是0到255)"
    default 255
    help
        其中0代表mute,1代表-121dB,243代表0dB,255代表6dB.增加1,音量增加0.5dB

config MD_X2600_510_ICODEC_MIN_DAC_VAL
    int "外放音量最小值(对应寄存器DACDGR的[0,7],可填范围是0到255)"
    default 0
    help
        其中0代表mute,1代表-121dB,243代表0dB,255代表6dB.增加1,音量增加0.5dB

endmenu
```

## vendor/module_driver/package/soc/x2600_510/mcu_riscv/Config.in
```kconfig
menuconfig MD_X2600_510_MCU
    bool "mcu(片内riscv mcu)"

config MD_X2600_510_MCU_ENABLE_JTAG
    bool "使能riscv 小核jtag 功能"
    default y

endmenu
```

## vendor/module_driver/package/soc/x2600_510/sslv/Config.in
```kconfig
menuconfig MD_X2600_510_SSLV
    bool "SSLV0"

config MD_X2600_510_SSLV0_CLK
    string "CLK(时钟引脚)"
    default PB28

config MD_X2600_510_SSLV0_DT
    string "DT(输出引脚)"
    default PB29

config MD_X2600_510_SSLV0_DR
    string "DR(输入引脚)"
    default PB30

config MD_X2600_510_SSLV0_CS
    string "CS(片选脚)"
    default PB31

endmenu # SPI SLV
```

## vendor/module_driver/package/soc/x2600_510/tcu/Config.in
```kconfig
menuconfig MD_X2600_510_TCU
    bool "tcu 驱动(gpio 时钟计数捕获)"

config MD_X2600_510_TCU0
    bool "选择tcu0 (/dev/jz_tcu)"
    default y

config MD_X2600_510_TCU1
    bool "选择tcu1 (/dev/jz_tcu1)"
    default n

endmenu
```

## vendor/module_driver/package/soc/x2600_510/watchdog/Config.in
```kconfig
menuconfig MD_X2600_510_WATCHDOG
    bool "watchdog 驱动(看门狗)"

config MD_X2600_510_WDT0_BUS
    bool "选择watchdog0"
    default n

config MD_X2600_510_WDT1_BUS
    bool "选择watchdog1"
    default n

endmenu
```

## vendor/ota_updater/Config.in
```kconfig
menuconfig APP_ota_updater
    bool "ota updater (ota升级)"

config APP_ota_updater_storage_medium
    string "Storage medium(存储介质)"
    choice from STORAGE_MEDIUM
    default mtd

config APP_ota_updater_version
    string "当前系统的ota版本号(每次编译新的ota版本时都应该递增此值)"
    default 0

config App_ota_updater_site
    string "ota 升级服务器的地址"
    default http://192.168.43.52/ota/board_test

config App_ota_updater_block_size
    int "ota 分包大小"
    default 1048576

config App_ota_updater_kernel_img_path
    string "ota kernel 镜像路径"
    default ../linux_test/output/xImage

config App_ota_updater_rootfs_img_path
    string "ota rootfs 镜像路径"
    default ../linux_test/output/rootfs.squashfs

config App_ota_updater_rtos
    bool "ota rtos 升级"
    default n

config App_ota_updater_rtos_img_path
    string "ota rtos 镜像路径"
    default ../linux_test/output/zero.bin
    depends on App_ota_updater_rtos

menu "ota uboot 不支持升级"
endmenu

endmenu

array STORAGE_MEDIUM
    string "storage_medium 存储介质"
    item "nand/nor  (mtd操作)" mtd
    item "mmc" mmc
```

## vendor/third_party/awtk/Config.in
```kconfig
menuconfig APP_awtk
    bool "awtk 平台支持"
    default n

menuconfig APP_awtk_config
    bool "awtk 可配置宏"
    default y

config APP_awtk_FB_DEVICE_FILENAME
    string "awtk 使用的 fb"
    default "/dev/fb0"

config APP_awtk_INPUT_DEVICE_NOSCAN
    bool "是否指定输入设备节点"
    default n

config APP_awtk_INPUT_DEVICE_FILENAME
    string "awtk 使用的输入节点（如果路径为目录，则扫描目录下所有的节点，如果路径为节点，则只扫描该节点）"
    depends on APP_awtk_INPUT_DEVICE_NOSCAN
    default "/dev/input/event0"

config APP_awtk_USE_GUI_MAIN
    bool "嵌入式系统有自己的main函数时"
    default n

config APP_awtk_WITH_BITMAP_FONT
    bool "支持预先解码的位图字体"
    default n

config APP_awtk_WITH_STB_IMAGE
    bool "支持png/jpeg图片"
    default y

config APP_awtk_WITH_STB_FONT
    bool "用stb支持Truetype字体"
    default y

config APP_awtk_WITH_FT_FONT
    bool "用freetype支持Truetype字体"
    default n

config APP_awtk_WITH_FS_RES
    bool "支持从文件系统加载资源"
    default y

config APP_awtk_WITH_UNICODE_BREAK
    bool "使用标准的UNICODE换行算法"
    default y

config APP_awtk_WITH_BITMAP_BGRA
    bool "将图片解码成BGRA8888格式，否则解码成RGBA8888的格式"
    default y

config APP_awtk_WITH_BITMAP_BGR565
    bool "将不透明的PNG图片解码成BGR565格式,如果LCD是此格式,则可以提高性能"
    default n

config APP_awtk_WITH_BITMAP_RGB565
    bool "将不透明的PNG图片解码成RGB565格式,如果LCD是此格式,则可以提高性能"
    default n

config APP_awtk_WITH_NULL_IM
    bool "不需输入法"
    default n

config APP_awtk_HAS_STD_MALLOC
    bool "有标准的malloc/free/calloc等函数"
    default y

config APP_awtk_HAS_PTHREAD
    bool "有标准的pthread等函数"
    default y

config APP_awtk_HAS_STDIO
    bool "有标准的fopen/fclose等函数"
    default y

config APP_awtk_HAS_FAST_MEMCPY
    bool "有优化版本的memcpy函数"
    default y

config APP_awtk_WITH_NANOVG_AGGE
    bool "启用agge作为nanovg的后端(较agg作为后端：大(56KB编译后)，快，图形质量稍差)"
    select APP_awtk_WITH_3RD_NANOVG
    select APP_awtk_NANOVG_BACKEND_AGGE
    default y

config APP_awtk_WITH_NANOVG_AGG
    bool "启用agg作为nanovg的后端(较agge作为后端：小，慢，图形质量好)"
    default n
    select APP_awtk_WITH_3RD_NANOVG
    select APP_awtk_NANOVG_BACKEND_AGG

config APP_awtk_ENABLE_CURSOR
    bool "启用鼠标指针"
    default y

config APP_awtk_WITH_VGCANVAS_CAIRO
    bool "启用cairo作为nanovg的后端"
    default n
    select APP_awtk_WITH_3RD_NANOVG
    select APP_awtk_VGCANVAS_CAIRO

config APP_awtk_WITHOUT_WIDGET_ANIMATORS
    bool "不使用控件动画"
    default n

config APP_awtk_WITHOUT_WINDOW_ANIMATORS
    bool "不使用窗口动画"
    default n

config APP_awtk_WITHOUT_DIALOG_HIGHLIGHTER
    bool "不使用对话框高亮策略"
    default n

config APP_awtk_WITHOUT_EXT_WIDGETS
    bool "不使用扩展控件"
    default n

config APP_awtk_WITH_WIDGET_TYPE_CHECK
    bool "控件类型检查"
    default y

config APP_awtk_WITH_WCSXXX
    bool "出现wcsxxx之类的函数没有定义时，请定义该宏"
    default n

config APP_awtk_WITH_INGENIC_LIB2D_G2D
    bool "使用 lib2d 进行加速"
    default n
    select APP_awtk_WITH_G2D

config APP_awtk_WITH_INGENIC_MSA_G2D
    bool "使用 msa 进行加速"
    default n
    select APP_awtk_WITH_G2D

config APP_awtk_WITH_3RD_NANOVG
    bool

config APP_awtk_VGCANVAS_CAIRO
    bool

config APP_awtk_NANOVG_BACKEND_AGG
    bool

config APP_awtk_NANOVG_BACKEND_AGGE
    bool

config APP_awtk_WITH_G2D
    bool

endmenu

config APP_awtk_demoui
    bool "demo ui"
    default n

endmenu # APP_awtk
```

## vendor/third_party/libiniparser/Config.in
```kconfig
menuconfig APP_iniparser
    bool "iniparser(INI文件开源解析器)"
    default n

endmenu
```

## vendor/third_party/lvgl/Config.in
```kconfig
menuconfig APP_lvgl
    bool "lvgl 平台支持"
    default n

config APP_lvgl_use_msa
    bool "使用 msa 优化后的绘制函数"
    default y

config APP_lvgl_use_jpeg_turbo
    bool "使用 jpeg turbo 支持jpg文件(buildroot 需选上jpeg turbo)"
    default n

config APP_media_video_player
    bool
    default n

config APP_lvgl_enable_backtrace
    bool "异常时使用backtrace,依赖glibc"
    default n

config APP_lvgl_h264_view_client
    bool "h264 view(依赖demos/multi_decode_display 的server 以及 libutils的cJSON 封装)"
    default n

config APP_lvgl_demo_widgets
    bool "lvgl_demo_widgets 应用"
    default n

config APP_lvgl_video_player
    bool "lvgl_video_player 应用"
    select APP_media_video_player
    default n

config APP_LVGL_VIDEO_PATH
    string "视频路径"
    default "/usr/data/"
    depends on APP_lvgl_video_player

config APP_lvgl_demo_ilock
    bool "demo ilock 门锁演示应用"
    default n

config APP_lvgl_demo_ilock2
    bool "demo ilock2 (带图标 门锁演示应用)"
    select APP_media_video_player
    default n

config APP_lvgl_demo_ilock_tuya
    bool "demo ilock tuya (带图标 tuya门锁演示应用)"
    default n

config APP_lvgl_demo_ilock_txt
    bool "demo ilock 门锁演示应用 (布局使用txt文本)"
    default n

endmenu # APP_libmedia
```

## vendor/wireless/bcm/Config.in
```kconfig
menuconfig APP_wireless_bcm
    bool "bcm bt/wifi"

config MD_WIFI_BCM_BOOT_UP
    bool "开机自启wifi"

choice "    选择相应的wifi固件拷贝到文件系统(目录为/lib/firmware/wifi_bcm/)"
    default MD_WIFI_FIRMWARE_43438

config MD_WIFI_FIRMWARE_43438
    bool "bcm43438的wifi固件"

config MD_WIFI_FIRMWARE_43438_INFINEON
    bool "infineon bcm43438的wifi固件"

config MD_WIFI_FIRMWARE_AP6212
    bool "ap6212的wifi固件"

config MD_WIFI_FIRMWARE_43456C5
    bool "bcm43456C5的wifi固件"

config MD_WIFI_FIRMWARE_43455C0
    bool "bcm43455C0的wifi固件"

config MD_WIFI_FIRMWARE_43362
    bool "bcm43362的wifi固件"

endchoice

config MD_BT_BSA_BOOT_UP
    bool "开机自启蓝牙，并加载蓝牙固件"

config MD_BT_UART_DEV_PATH
    string "uart dev path(串口设备路径)"
    default /dev/ttyS0
    help
        用来下载固件的串口设备路径

choice "    bt firmware(选择蓝牙固件)"
    default MD_BT_FIRMWARE_43438

config MD_BT_FIRMWARE_43438
    bool "bcm43438的bt固件"

config MD_BT_FIRMWARE_43438_INFINEON
    bool "infineon bcm43438的bt固件"

config MD_BT_FIRMWARE_AP6212
    bool "ap6212的bt固件"

config MD_BT_FIRMWARE_43455C0
    bool "bcm43455C0的bt固件"

config MD_BT_FIRMWARE_43456C5
    bool "bcm43456C5的bt固件"

endchoice

choice "    选择对应平台的bsa工具包"
    default MD_BT_BSA_XBURST1

config MD_BT_BSA_XBURST2
    bool "xburst2 (x2000, m300等)"

config MD_BT_BSA_XBURST1
    bool "xburst1(x1000, x1021, 1830等)"

endchoice

endmenu
```
