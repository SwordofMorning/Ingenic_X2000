## vendor/module_driver/package/soc/x2580/aic/Config.in
```kconfig
menuconfig MD_X2580_AIC
    bool "aic(i2s 接口)"

config MD_X2580_AIC_SELECT_GPIO
    int "i2s引脚选择(仅外部codec有效)"
    choice from MD_x2580_AIC_GPIO_CHOICE_LIST
    help
        选用PB/PC引脚

config MD_X2580_AIC_SELECT_CLOCK
    int "选择rx和tx的时钟是否独立(仅外部codec有效)"
    choice from MD_x2580_AIC_CLK_CHOICE_LIST
    help
        时钟完全独立指tx和rx的mclk、bclk、lrclk相互独立
        时钟共享tx_mclk指i2s的tx和rx共享tx_mclk，但bclk和lrclk独立
        时钟完全共享指tx和rx的mclk、bclk、lrclk相互共享

endmenu # aic(i2s 接口)

array MD_x2580_AIC_GPIO_CHOICE_LIST
    int "i2s引脚选项"
    item "PB: tx/rx: mclk:11/10, bclk:8/13, lrck:9/14, data:16/15" 0
    item "PC: tx/rx: mclk:11/12, bclk:15/13, lrck:16/14, data:17/18" 1

array MD_x2580_AIC_CLK_CHOICE_LIST
    int "选择rx和tx的时钟选项"
    item "i2s rx和tx的时钟完全独立" 0
    item "i2s rx和tx共享tx_mclk" 1
    item "i2s rx和tx共享所有的时钟" 2
```

## vendor/module_driver/package/soc/x2580/camera-double/Config.in
```kconfig
array SOC_X2580_CAMERA_MCLK_IO
    string "X2580 MCLK 引脚"
    item "PC15" PC15
    item "PA15" PA15

menuconfig MD_X2580_CAMERA_VIC_DOUBLE
    bool "camera 双摄驱动(vic控制器)"
    select MD_RMEM_MANAGER

config MD_X2580_CAMERA_VIC_DOUBLE_CTL
    bool "选择VIC控制器"
    default y

config MD_X2580_CAMERA_VIC_DOUBLE_MCLK
    string "VIC MCLK管脚选择"
    default PA15
    choice from SOC_X2580_CAMERA_MCLK_IO
    depends on MD_X2580_CAMERA_VIC_DOUBLE_CTL

config MD_X2580_CAMERA_VIC_DOUBLE_GPIO_MIPI_SWITCH
    string "VIC 双摄切换引脚"
    default -1
    choice from SOC_GPIO_PINS
    depends on MD_X2580_CAMERA_VIC_DOUBLE_CTL

choice "      选择VIC 数据通路(ISP/DDR)"
    default MD_X2580_CAMERA_VIC_DOUBLE_ISP_DISABLE
    depends on MD_X2580_CAMERA_VIC_DOUBLE_CTL

config MD_X2580_CAMERA_VIC_DOUBLE_ISP_DISABLE
    bool "    VIC数据不通过ISP模块"

config MD_X2580_CAMERA_VIC_DOUBLE_ISP_ENABLE
    bool "    VIC数据通过ISP模块"

endchoice

config MD_X2580_CAMERA_VIC_DOUBLE_FRAME_NUMS
    int "VIC Camera 帧缓冲数 "
    default 2
    depends on MD_X2580_CAMERA_VIC_DOUBLE_CTL

endmenu
```

## vendor/module_driver/package/soc/x2580/camera/Config.in
```kconfig
array SOC_X2580_CAMERA_MCLK_IO
    string "X2580 MCLK 引脚"
    item "PC15" PC15
    item "PA15" PA15

menuconfig MD_X2580_CAMERA_VIC
    bool "camera 驱动(vic控制器)"
    select MD_RMEM_MANAGER

config MD_X2580_CAMERA_VIC_CTL
    bool "选择VIC控制器"

config MD_X2580_CAMERA_VIC_MCLK
    string "VIC MCLK管脚选择"
    default PA15
    choice from SOC_X2580_CAMERA_MCLK_IO
    depends on MD_X2580_CAMERA_VIC_CTL

choice "      选择VIC 数据通路(ISP/DDR)"
    default MD_X2580_CAMERA_VIC_ISP_DISABLE
    depends on MD_X2580_CAMERA_VIC_CTL

config MD_X2580_CAMERA_VIC_ISP_DISABLE
    bool "    VIC数据不通过ISP模块"

config MD_X2580_CAMERA_VIC_ISP_ENABLE
    bool "    VIC数据通过ISP模块"

endchoice

config MD_X2580_CAMERA_VIC_FRAME_NUMS
    int "VIC Camera 帧缓冲数 "
    default 2
    depends on MD_X2580_CAMERA_VIC_CTL

endmenu
```

## vendor/module_driver/package/soc/x2580/dmic/Config.in
```kconfig
menuconfig MD_X2580_DMIC
    bool "dmic(外接数字mic)"
    select MD_X2580_AUDIO_DMA

config MD_X2580_DMIC_SELECT_GPIO
    int "dmic引脚选择"
    choice from MD_x2580_DMIC_GPIO_CHOICE_LIST
    default 1
    help
        选用PA/PB引脚

config MD_X2580_DMIC_INT0
    bool "使能dmic通道0,1"
    default y

config MD_X2580_DMIC_INT1
    bool "使能dmic通道2,3"
    default n

endmenu

array MD_x2580_DMIC_GPIO_CHOICE_LIST
    int "dmic引脚选项"
    item "(1.8v)clk, in0, in1:PA 14, 16, 17" 0
    item "(3.3v)clk, in0, in1:PB 28, 29, 30" 1
```

## vendor/module_driver/package/soc/x2580/icodec/Config.in
```kconfig
menuconfig MD_X2580_ICODEC
    bool "icodec(内部codec)"
    select MD_X2580_AIC

config MD_X2580_ICODEC_BAIS_ON
    bool "开启偏置电压（录音时打开）"
    default y
    help
        对于外接的模拟mic,内部codec需要提前打开偏置电压
        对于回采电路，则不需要打开偏置电压

config MD_X2580_ICODEC_BAIS_LEVEL
    int "偏置电压的寄存器数值(范围0-7)"
    default 7

config MD_X2580_ICODEC_SPK_GPIO
    string "功放引脚"
    choice from SOC_GPIO_PINS
    default -1

config MD_X2580_ICODEC_SPK_GPIO_LEVEL
    string "功放引脚使能电平"
    choice from MD_GPIO_ACTIVE_LEVEL
    default 1

config MD_X2580_ICODEC_SPK_NEED_DELAY_MS
    int "功放引脚使能后需要的延时时间(ms)"
    default 20
    help
        部分功放芯片的时序需要在使能功放引脚后加一定的延时

config MD_X2580_ICODEC_MAX_HPOUT_VAL
    int "外放音量最大值(对应寄存器CHPOUTLGR的[0,4],可填范围是0到31)"
    default 31
    help
        其中0代表-39dB，26代表0dB,31代表6dB.增加1，音量增加1.5dB

config MD_X2580_ICODEC_MIN_HPOUT_VAL
    int "外放音量最小值(对应寄存器CHPOUTLGR的[0,4],可填范围是0到31)"
    default 0
    help
        其中0代表-39dB，26代表0dB,31代表6dB.增加1，音量增加1.5dB

endmenu
```

## vendor/module_driver/package/soc/x2580/mac/Config.in
```kconfig
menuconfig MD_X2580_MAC
    bool "mac 以太网控制器驱动"

array MAC_PHY_MDC
    int "设置PHY MDIO时钟"
    item " 根据phy clk自动计算 " 0xff
    item " MDC=18.75MHz " 0x0
    item " MDC=11.54HMz " 0x1
    item " MDC=7.14MHz " 0x2
    item " MDC=4.84MHz " 0x3
    item " MDC=2.94MHz " 0x4
    item " MDC=2.42MHz " 0x5

config MD_X2580_PHY_PROBE_MASK
    int "PHY探测屏蔽(范围：0x0～0xffffffff)"
    default 0x0
    help
        phy探测屏蔽为32位代表32个地址(0:使能探测 1:屏蔽探测)
        例如：0xfffffff0(探测前4个地址)

config MD_X2580_PHY_CLK_DELAY_US
    int "PHY CLK 使能后延迟时间再通讯(单位：us)"
    default 0

config MD_X2580_PHY_RESET_TIME_US
    int "PHY复位时间(单位：us)"
    default 10000

config MD_X2580_PHY_RESET_GPIO
    string "PHY 复位引脚"
    choice from SOC_GPIO_PINS
    default -1

config MD_X2580_PHY_VALID_LEVEL
    string "PHY 复位电平"
    choice from PHY_RESET_LEVEL
    default 0

config MD_X2580_PHY_MDC
    string "MAC PHY MDIO 时钟"
    choice from MAC_PHY_MDC
    default 0xff

config MD_X2580_VIRTUAL_PHY
    bool "外接虚拟phy设备，RMII直接通讯，用于两个mac互接省略phy芯片或用于直接与FPGA芯片通讯"
    default n

endmenu

array PHY_RESET_LEVEL
    string "RESET_LEVEL"
    item "RESET_LEVEL" 0
    item "RESET_LEVEL" 1
```

## vendor/module_driver/package/soc/x2580/spi/Config.in
```kconfig
array SOC_x2580_SPI0_MISO_IO
    string "SPI0 MISO(DR) 引脚"
    item "GPIO_NULL  " -1
    item "PA09" PA09
    item "PC05" PC05

array SOC_x2580_SPI0_MOSI_IO
    string "SPI0 MOSI(DT) 引脚"
    item "GPIO_NULL  " -1
    item "PA08" PA08
    item "PC04" PC04

array SOC_x2580_SPI0_CLK_IO
    string "SPI0 CLK 引脚"
    item "GPIO_NULL  " -1
    item "PA06" PA06
    item "PC02" PC02



array SOC_x2580_SPI1_MISO_IO
    string "SPI1 MISO(DR) 引脚"
    item "GPIO_NULL  " -1
    item "PA21" PA21
    item "PB29" PB29

array SOC_x2580_SPI1_MOSI_IO
    string "SPI1 MOSI(DT) 引脚"
    item "GPIO_NULL  " -1
    item "PA20" PA20
    item "PB27" PB27

array SOC_x2580_SPI1_CLK_IO
    string "SPI1 CLK 引脚"
    item "GPIO_NULL  " -1
    item "PA22" PA22
    item "PB28" PB28



menu "SPI 总线"
    help
        "依赖于 SPI 驱动"

config MD_x2580_SPI
    bool

config MD_x2580_SPI_CLK_RATE
    int "SPI内部时钟源频率(单位Hz)"
    default 100000000
    help
            SPI频率 = SPI内部时钟源频率 / (2 * (CGV + 1))
            CGV范围: 0 ~ 255
            当前SPI频率范围: 195312.5 ~ 50000000

config MD_x2580_SPI0
    bool "选择 SPI0"
    select MD_x2580_SPI

config MD_x2580_SPI0_MISO
    string "        MISO(输入引脚)"
    default PA09
    choice from SOC_x2580_SPI0_MISO_IO
    depends on MD_x2580_SPI0
    help
        "MISO= -1,表示不使用MISO引脚"

config MD_x2580_SPI0_MOSI
    string "        MOSI(输出引脚)"
    default PA08
    choice from SOC_x2580_SPI0_MOSI_IO
    depends on MD_x2580_SPI0
    help
        "MOSI= -1,表示不使用MOSI引脚"

config MD_x2580_SPI0_CLK
    string "        CLK(时钟引脚)"
    default PA06
    choice from SOC_x2580_SPI0_CLK_IO
    depends on MD_x2580_SPI0


config MD_x2580_SPI1
    bool "选择 SPI1"
    select MD_x2580_SPI

config MD_x2580_SPI1_MISO
    string "        MISO(输入引脚)"
    default PA21
    choice from SOC_x2580_SPI1_MISO_IO
    depends on MD_x2580_SPI1
    help
        "MISO= -1,表示不使用MISO引脚"

config MD_x2580_SPI1_MOSI
    string "        MOSI(输出引脚)"
    default PA20
    choice from SOC_x2580_SPI1_MOSI_IO
    depends on MD_x2580_SPI1
    help
        "MOSI= -1,表示不使用MOSI引脚"

config MD_x2580_SPI1_CLK
    string "        CLK(时钟引脚)"
    default PA22
    choice from SOC_x2580_SPI1_CLK_IO
    depends on MD_x2580_SPI1

endmenu # SPI 总线
```

## vendor/module_driver/package/soc/x2580/utils/Config.in
```kconfig
menuconfig MD_X2580_UTILS
    bool "utils 驱动(芯片的一些小功能)"

config MD_X2580_UTILS_RTC32K
    bool "rtc32k 时钟bypas输出(PC16)"
    default y

config MD_X2580_UTILS_RTC32K_INIT_ON
    bool "        初始化即使能rtc32k输出"
    depends on MD_X2580_UTILS_RTC32K


config MD_X2580_UTILS_CLK24M
    bool "clk24m 时钟bypas输出(PC15)"
    default y

config MD_X2580_UTILS_CLK24M_INIT_ON
    bool "        初始化即使能clk24m输出"
    depends on MD_X2580_UTILS_CLK24M

endmenu
```

## vendor/module_driver/package/soc/x2600_510/Config.in
```kconfig
menuconfig MD_SOC_X2600_510
    bool "x2600驱动列表"
    depends on MD_CHOICE_SOC_X2600_510_BASE

config MD_SOC_DIR
    string
    default soc/x2600_510

source package/soc/x2600_510/def_gpio_pins.in

source package/soc/x2600_510/gpio/Config.in
source package/soc/x2600_510/audio_dma/Config.in
source package/soc/x2600_510/aic/Config.in
source package/soc/x2600_510/icodec/Config.in
source package/soc/x2600_510/watchdog/Config.in
source package/soc/x2600_510/watchdog1_timer/Config.in
source package/soc/x2600_510/tcu/Config.in
source package/soc/x2600_510/dtrng/Config.in
source package/soc/x2600_510/i2c/Config.in
source package/soc/x2600_510/can/Config.in

source package/soc/x2600_510/efuse/Config.in
source package/soc/x2600_510/fb/Config.in
source package/soc/x2600_510/fb_layer_mixer/Config.in
source package/soc/x2600_510/aes/Config.in

source package/soc/x2600_510/mcu_riscv/Config.in
source package/soc/x2600_510/hash/Config.in
source package/soc/x2600_510/utils/Config.in
source package/soc/x2600_510/msc/Config.in

source package/soc/x2600_510/spi/Config.in
source package/soc/x2600_510/sslv/Config.in

source package/soc/x2600_510/dmic/Config.in

source package/soc/x2600_510/pwm/Config.in
source package/soc/x2600_510/mac/Config.in
source package/soc/x2600_510/adc/Config.in
source package/soc/x2600_510/camera/Config.in
endmenu
```

## vendor/module_driver/package/soc/x2600_510/camera/Config.in
```kconfig
array SOC_X2600_510_CAMERA_MCLK_IO
    string "X2600_510 MCLK 引脚"
    item "PA11" PA11
    item "PE(02)    24M晶振旁路,输出频率不可调整" PE02

menuconfig MD_X2600_510_CAMERA
    bool "camera 驱动(cim控制器)"


config MD_X2600_510_CAMERA_MCLK
    string "CIM MCLK管脚选择"
    default PA11
    choice from SOC_X2600_510_CAMERA_MCLK_IO

config MD_X2600_510_CAMERA_CIM_FRAME_NUMS
    int "CIM Camera 帧缓冲数 "
    default 2

endmenu
```

## vendor/module_driver/package/soc/x2600_510/can/Config.in
```kconfig
array SOC_X2600_510_CAN0_DR_IO
    string "CAN0 DR 引脚"
    item "GPIO_NULL  " -1
    item "PC08" PC08

array SOC_X2600_510_CAN0_DT_IO
    string "CAN0 DT 引脚"
    item "GPIO_NULL  " -1
    item "PC07" PC07


array SOC_X2600_510_CAN1_DR_IO
    string "CAN1 DR 引脚"
    item "GPIO_NULL  " -1
    item "PC10" PC10

array SOC_X2600_510_CAN1_DT_IO
    string "CAN1 DT 引脚"
    item "GPIO_NULL  " -1
    item "PC09" PC09



menuconfig MD_X2600_510_CAN
    bool "can 总线"

config MD_X2600_510_CAN0
    bool "选择 CAN0"

config MD_X2600_510_CAN0_RX
    string "    DR(输入引脚)"
    default PC08
    choice from SOC_X2600_510_CAN0_DR_IO
    depends on MD_X2600_510_CAN0

config MD_X2600_510_CAN0_TX
    string "    DT(输出引脚)"
    default PC07
    choice from SOC_X2600_510_CAN0_DT_IO
    depends on MD_X2600_510_CAN0


config MD_X2600_510_CAN1
    bool "选择 CAN1"

config MD_X2600_510_CAN1_RX
    string "    DR(输入引脚)"
    default PC10
    choice from SOC_X2600_510_CAN1_DR_IO
    depends on MD_X2600_510_CAN1

config MD_X2600_510_CAN1_TX
    string "    DT(输出引脚)"
    default PC09
    choice from SOC_X2600_510_CAN1_DT_IO
    depends on MD_X2600_510_CAN1

endmenu # CAN 总线
```

## vendor/module_driver/package/soc/x2600_510/dmic/Config.in
```kconfig
menuconfig MD_X2600_510_DMIC
    bool "dmic(外接数字mic)"
    select MD_X2600_510_AUDIO_DMA

config MD_X2600_510_DMIC_INT0
    bool "使能dmic通道0,1（PC05）"
    default y

config MD_X2600_510_DMIC_INT1
    bool "使能dmic通道2,3（PC06）"
    default n

config MD_X2600_510_CLK_SELECT
    bool "dmic 工作频率"
    default y

choice "dmic 工作频率"
    default MD_X2600_510_CLK_2400KHz
    depends on  MD_X2600_510_CLK_SELECT

config MD_X2600_510_CLK_2400KHz
    bool "选择dmic的工作频率为2.4MHz"

config MD_X2600_510_CLK_3072KHz
    bool "选择dmic的工作频率为3.072MHz"

endchoice

endmenu #MD_X2600_510_DMIC
```
