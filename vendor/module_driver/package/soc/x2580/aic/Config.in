## vendor/module_driver/package/soc/x2600_510/fb/Config.in
```kconfig
array MD_X2600_510_FB_ROTATOR_ANGLE_LIST
    int "rotator 旋转角度"
    item "旋转0°" 0
    item "旋转90°" 90
    item "旋转180°" 180
    item "旋转270°" 270

menuconfig MD_X2600_510_FB
    bool "framebuffer 驱动(lcd/dpu控制器)"
    select MD_X2600_510_FB_LAYER_MIXER
    select MD_RMEM_MANAGER

config MD_X2600_510_RTOS_BOOT_LOGO_FOR_KERNEL
    bool "rtos 中已初始化过 lcd (此时无需再初始化)"
    default n
    help
        rtos 中已初始化过 lcd, 无需再初始化

config MD_X2600_510_FB_INIT_BY_USER
    bool "framebuffer 驱动初始化由应用层触发"
    default n
    help
        当riscv小核用到fb驱动时，xburst2大核等待小核释放资源再做初始化

config MD_X2600_510_FB_PAN_DISPLAY_SYNC
    bool "pan_display 调用时等待帧刷新完成(单缓冲时选中)"
    default y

config MD_X2600_510_FB_MIPI_CMD_WAITTIME_US
    int "mipi write_cmd 等待时长 (单位为us)(快启时根据屏特性自行设定)"
    default 1000

menuconfig MD_X2600_510_FB_CFG_MIPI_SWAP
    bool "mipi lane_P/N pin 交换"
    default n

config MD_X2600_510_FB_MIPI_CLK_PIN
    bool "将 clk 的 p脚 和 n脚 功能互换"
    default n

config MD_X2600_510_FB_MIPI_LANE0_PIN
    bool "将 lane0 的 p脚 和 n脚 功能互换"
    default n

config MD_X2600_510_FB_MIPI_LANE1_PIN
    bool "将 lane1 的 p脚 和 n脚 功能互换"
    default n

config MD_X2600_510_FB_MIPI_LANE2_PIN
    bool "将 lane2 的 p脚 和 n脚 功能互换"
    default n

config MD_X2600_510_FB_MIPI_LANE3_PIN
    bool "将 lane3 的 p脚 和 n脚 功能互换"
    default n

endmenu

choice "选择数据通路(MIXER/SRDMA/LAYER)"
    default MD_X2600_510_FB_LAYER_ENABLE
config MD_X2600_510_FB_MIXER_ENABLE
    bool "mixer(多fb叠加到内存+srdma)输出"
    select MD_X2600_510_FB_USE_MIXER
config MD_X2600_510_FB_ROTATOR_ENABLE
    bool "rotator(多fb叠加到内存+rotator)输出"
    select MD_X2600_510_FB_USE_ROTATOR
config MD_X2600_510_FB_SRDMA_ENABLE
    bool "srdma(单fb无叠加)输出"
    select MD_X2600_510_FB_USE_SRDMA
config MD_X2600_510_FB_LAYER_ENABLE
    bool "layer(多fb叠加直通lcd)输出"
    select MD_X2600_510_FB_USE_LAYER
endchoice

config MD_X2600_510_FB_USE_MIXER
    bool
    select MD_X2600_510_FB_USE_SRDMA
    select MD_X2600_510_FB_USE_LAYER

config MD_X2600_510_FB_USE_ROTATOR
    bool
    select MD_X2600_510_FB_USE_LAYER
    select MD_X2600_510_FB_CFG_ROTATOR

config MD_X2600_510_FB_USE_SRDMA
    bool
    select MD_X2600_510_FB_SRDMA_CONFIG

config MD_X2600_510_FB_USE_LAYER
    bool
    select MD_X2600_510_FB_LAYER_CONFIG

config MD_X2600_510_FB_CFG_ROTATOR
    bool "旋转"
    depends on MD_X2600_510_FB_USE_ROTATOR

config MD_X2600_510_FB_ROTATOR_ANGLE
    int "旋转角度"
    default 90
    choice from MD_X2600_510_FB_ROTATOR_ANGLE_LIST
    depends on MD_X2600_510_FB_CFG_ROTATOR

config MD_X2600_510_FB_ROTATOR_FRAMES
    int "旋转帧缓冲数"
    default 2
    depends on MD_X2600_510_FB_CFG_ROTATOR

config MD_X2600_510_FB_SRDMA_CONFIG
    bool "srdma配置"
    depends on MD_X2600_510_FB_USE_SRDMA

config MD_X2600_510_FB_SRDMA_FRAMES
    int "srdma 的帧缓冲数(或mixer模式下叠加后输出的帧缓冲数)"
    depends on MD_X2600_510_FB_SRDMA_CONFIG
    default 2

menuconfig MD_X2600_510_FB_LAYER_CONFIG
    bool "layer/mixer/rotator(多层fb叠加)配置"
    depends on MD_X2600_510_FB_USE_LAYER

config MD_X2600_510_FB_USE_DEFAULT_ORDER
    bool "强制使用默认的层级配置（fb0为最低层，fb3为最顶层，应用配置无效）"

config MD_X2600_510_FB_LAYER0_ENABLE
    bool "使能fb0"

config MD_X2600_510_FB_LAYER0_FRAMES
    int "fb0 的帧缓冲数"
    default 1

config MD_X2600_510_FB_LAYER0_ALPHA
    int "fb0 的透明度(0-255)"
    default 255

config MD_X2600_510_FB_LAYER1_ENABLE
    bool "使能fb1"

config MD_X2600_510_FB_LAYER1_FRAMES
    int "fb1 的帧缓冲数"
    default 1

config MD_X2600_510_FB_LAYER1_ALPHA
    int "fb1 的透明度(0-255)"
    default 255

config MD_X2600_510_FB_LAYER2_ENABLE
    bool "使能fb2"

config MD_X2600_510_FB_LAYER2_FRAMES
    int "fb2 的帧缓冲数"
    default 1

config MD_X2600_510_FB_LAYER2_ALPHA
    int "fb2 的透明度(0-255)"
    default 255

config MD_X2600_510_FB_LAYER3_ENABLE
    bool "使能fb3"

config MD_X2600_510_FB_LAYER3_FRAMES
    int "fb3 的帧缓冲数"
    default 1

config MD_X2600_510_FB_LAYER3_ALPHA
    int "fb3 的透明度(0-255)"
    default 255

menuconfig MD_X2600_510_FB_ENABLE_USER_CONFIG
    bool "自定义fb的尺寸"

menuconfig MD_X2600_510_FB_LAYER0_USER_ENABLE
    bool "使能fb0自定义"
    default n

config MD_X2600_510_FB_LAYER0_USER_WIDTH
    int "fb0的宽"
    default -1

config MD_X2600_510_FB_LAYER0_USER_HEIGHT
    int "fb0的高"
    default -1

config MD_X2600_510_FB_LAYER0_USER_XPOS
    int "fb0的在lcd水平方向的偏移"
    default 0

config MD_X2600_510_FB_LAYER0_USER_YPOS
    int "fb0的在lcd垂直的偏移"
    default 0

config MD_X2600_510_FB_LAYER0_USER_SCALING_ENABLE
    bool "使能缩放"
    default n

config MD_X2600_510_FB_LAYER0_USER_SCALING_WIDTH
    int "缩放后在lcd显示的宽度"
    depends on MD_X2600_510_FB_LAYER0_USER_SCALING_ENABLE
    default -1

config MD_X2600_510_FB_LAYER0_USER_SCALING_HEIGHT
    int "缩放后在lcd显示的长度"
    depends on MD_X2600_510_FB_LAYER0_USER_SCALING_ENABLE
    default -1

endmenu

menuconfig MD_X2600_510_FB_LAYER1_USER_ENABLE
    bool "使能fb1自定义"
    default n

config MD_X2600_510_FB_LAYER1_USER_WIDTH
    int "fb1的宽"
    default -1

config MD_X2600_510_FB_LAYER1_USER_HEIGHT
    int "fb1的高"
    default -1

config MD_X2600_510_FB_LAYER1_USER_XPOS
    int "fb1的在lcd水平方向的偏移"
    default 0

config MD_X2600_510_FB_LAYER1_USER_YPOS
    int "fb1的在lcd垂直的偏移"
    default 0

config MD_X2600_510_FB_LAYER1_USER_SCALING_ENABLE
    bool "使能缩放"
    default n

config MD_X2600_510_FB_LAYER1_USER_SCALING_WIDTH
    int "缩放后在lcd显示的宽度"
    depends on MD_X2600_510_FB_LAYER1_USER_SCALING_ENABLE
    default -1

config MD_X2600_510_FB_LAYER1_USER_SCALING_HEIGHT
    int "缩放后在lcd显示的长度"
    depends on MD_X2600_510_FB_LAYER1_USER_SCALING_ENABLE
    default -1

endmenu

menuconfig MD_X2600_510_FB_LAYER2_USER_ENABLE
    bool "使能fb2自定义"
    default n

config MD_X2600_510_FB_LAYER2_USER_WIDTH
    int "fb2的宽"
    default -1

config MD_X2600_510_FB_LAYER2_USER_HEIGHT
    int "fb2的高"
    default -1

config MD_X2600_510_FB_LAYER2_USER_XPOS
    int "fb2的在lcd水平方向的偏移"
    default 0

config MD_X2600_510_FB_LAYER2_USER_YPOS
    int "fb2的在lcd垂直的偏移"
    default 0

config MD_X2600_510_FB_LAYER2_USER_SCALING_ENABLE
    bool "使能缩放"
    default n

config MD_X2600_510_FB_LAYER2_USER_SCALING_WIDTH
    int "缩放后在lcd显示的宽度"
    depends on MD_X2600_510_FB_LAYER2_USER_SCALING_ENABLE
    default -1

config MD_X2600_510_FB_LAYER2_USER_SCALING_HEIGHT
    int "缩放后在lcd显示的长度"
    depends on MD_X2600_510_FB_LAYER2_USER_SCALING_ENABLE
    default -1

endmenu

menuconfig MD_X2600_510_FB_LAYER3_USER_ENABLE
    bool "使能fb3自定义"
    default n

config MD_X2600_510_FB_LAYER3_USER_WIDTH
    int "fb3的宽"
    default -1

config MD_X2600_510_FB_LAYER3_USER_HEIGHT
    int "fb3的高"
    default -1

config MD_X2600_510_FB_LAYER3_USER_XPOS
    int "fb3的在lcd水平方向的偏移"
    default 0

config MD_X2600_510_FB_LAYER3_USER_YPOS
    int "fb3的在lcd垂直的偏移"
    default 0

config MD_X2600_510_FB_LAYER3_USER_SCALING_ENABLE
    bool "使能缩放"
    default n

config MD_X2600_510_FB_LAYER3_USER_SCALING_WIDTH
    int "缩放后在lcd显示的宽度"
    depends on MD_X2600_510_FB_LAYER3_USER_SCALING_ENABLE
    default -1

config MD_X2600_510_FB_LAYER3_USER_SCALING_HEIGHT
    int "缩放后在lcd显示的长度"
    depends on MD_X2600_510_FB_LAYER3_USER_SCALING_ENABLE
    default -1

endmenu

endmenu

endmenu

endmenu
```

## vendor/module_driver/package/soc/x2600_510/fb_layer_mixer/Config.in
```kconfig
menuconfig MD_X2600_510_FB_LAYER_MIXER
    bool "fb_layer_mixer"

config MD_X2600_510_FB_LAYER_MIXER_INIT_BY_USER
    bool "fb_layer_mixer驱动初始化由应用层触发"
    default n
    help
        当riscv小核用到fb驱动时，xburst2大核等待小核释放资源再做初始化

endmenu
```
