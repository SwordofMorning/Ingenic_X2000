## vendor/libimpf/Config.in
```kconfig
menuconfig APP_libimpf
    bool "libimpf (X1830/X1520 isp接口/命令)"
    default n

choice "impf 版本选择"
	default APP_libimpf_v120

config APP_libimpf_v120
	bool "for x1520"

config APP_libimpf_v130
	bool "for x1830"

endchoice

config APP_libimpf_base_interface_cmd
    bool "base_interface(获取视频流)"
    default n

config APP_libimpf_dec_jpeg_cmd
    bool "dec_jpeg(jpeg解码成nv12)"
    default n

config APP_libimpf_enc_h264_jpeg_cmd
    bool "enc_h264_jpeg(nv12编码成h264和jpeg)"
    default n

config APP_libimpf_fs_bgra_display_cmd
    bool "fs_bgra_display(nv12格式转换成bgra显示到屏上)"
    default n

config APP_libimpf_fs_nv12_cmd
    bool "fs_nv12(输出经过isp处理的两种分辨率图像，通道0为原始分辨率，通道1为缩放后的分辨率)"
    default n

config APP_libimpf_fs_raw_cmd
    bool "fs_raw(输出sensor未经isp加工数据)"
    default n

config APP_libimpf_demo_isp_cmd
    bool "demo_isp(输出经过isp处理的一种分辨率图像，通道0为原始分辨率)"
    default y

config APP_libimpf_demo_osd_enc_jpeg_cmd
    bool "osd_enc_jpeg(nv12经过osd叠加水印编码成jpeg)"
    default n

config APP_libimpf_demo_host_uvc_cmd
    bool "host_uvc(获取设备端usb摄像头的图像)"
    default n

config APP_libimpf_demo_device_uvc_cmd
    bool "device_uvc(输出yuv格式的图像通过usb输出到主机)"
    default n

endmenu
```

## vendor/libisp/Config.in
```kconfig
menuconfig APP_libisp
    bool "libisp (X2000/X2580 isp接口/命令)"
    default y

choice "soc选择"
    default APP_libisp_x2000

config APP_libisp_x2000
    bool "for x2000"

config APP_libisp_x2580
    bool "for x2580"

endchoice

config APP_libisp_isp_cmd
    bool "isp shell命令"
    default y

config APP_libisp_demo_isp_cmd
    bool "demo_isp(Camera经过ISP获取图像数据)"
    depends on APP_libisp_x2000
    default y

config APP_libisp_demo_isp_nv12_preview_cmd
    bool "demo_isp_nv12_preview(Camera经过ISP获取图像数据,并在FB上预览)"
    depends on APP_libisp_x2000
    default y

config App_libisp_mult_chan_preview_cmd
    bool "mult_chan_preview(预览多通道ISP数据)"
    depends on APP_libisp_x2000
    default y

config App_libisp_demo_frame_sync_cmd
    bool "frame sync(双摄帧同步)"
    depends on APP_libisp_x2000
    default y

config APP_libisp_demo_isp_jpeg_encode_cmd
    bool "demo_isp_jpeg_encode(Camera经过ISP获取图像数据,并且编码成JPEG格式图片)"
    depends on APP_libisp_x2000
    default y

config APP_libisp_demo_isp_h264_encode_cmd
    bool "demo_isp_h264_encode(Camera经过ISP获取图像数据,并且编码成H264格式图片)"
    depends on APP_libisp_x2000
    default y

config APP_libisp_demo_isp_x2580_cmd
    bool "demo_isp_x2580命令"
    depends on APP_libisp_x2580
    default y

config APP_libisp_demo_isp_h264_encode_x2580_cmd
    bool "demo_isp_h264_encode_x2580 命令"
    depends on APP_libisp_x2580
    default y

config APP_libisp_demo_isp_jpeg_encode_x2580_cmd
    bool "demo_isp_jpeg_encode_x2580 命令"
    depends on APP_libisp_x2580
    default y

endmenu
```

## vendor/libmcu/Config.in
```kconfig
menuconfig APP_libmcu
    bool "libmcu (片上小核)"
    default y

source soc/Config.in
source options/Config.in
source devices/Config.in
source drivers/Config.in
source lib/Config.in
source newlib/Config.in
source third_party/Config.in
source vendor/Config.in

endmenu
```
