## vendor/libmcu/devices/Config.in
```kconfig
menuconfig APP_libmcu_device
    bool "外设"
    default y

source devices/lcd/Config.in

endmenu
```

## vendor/libmcu/devices/lcd/Config.in
```kconfig
menuconfig APP_libmcu_device_lcd
    bool "lcd设备列表"
    default y

source devices/lcd/x2600/lcd_fw050/Config.in
source devices/lcd/x2600/lcd_kx070/Config.in

endmenu
```

## vendor/libmcu/devices/lcd/x2600/lcd_fw050/Config.in
```kconfig
menuconfig APP_libmcu_device_x2600_lcd_fw050
    bool "TFT FW050 (720x1280) (X2600) (mipi接口)"
    select APP_libmcu_x2600_fb
    depends on APP_libmcu_x2600

config APP_libmcu_device_x2600_fw050_4lane_en
    bool "使能 4lane 通道"
    default n

config APP_libmcu_device_x2600_fw050_backlight_pin
    string "gpio backlight pin(lcd backlight使能引脚)"
    choice from SOC_GPIO_PINS
    default -1

config APP_libmcu_device_x2600_fw050_backlight_level
    int "gpio backlight level(lcd backlight使能引脚 有效电平)"
    default 1

config APP_libmcu_device_x2600_fw050_rst_pin
    string "gpio reset pin(lcd 复位引脚)"
    choice from SOC_GPIO_PINS
    default -1

config APP_libmcu_device_x2600_fw050_rst_level
    int "gpio reset level(lcd 复位引脚 有效电平)"
    default 0

config APP_libmcu_device_x2600_fw050_power_pin
    string "gpio power pin(lcd power使能引脚)"
    choice from SOC_GPIO_PINS
    default -1

config APP_libmcu_device_x2600_fw050_power_level
    string "gpio power level(lcd power使能引脚 有效电平)"
    default 1

endmenu # APP_libmcu_device_x2600_lcd_fw050
```

## vendor/libmcu/devices/lcd/x2600/lcd_kx070/Config.in
```kconfig
menuconfig APP_libmcu_device_x2600_lcd_kx070
    bool "TFT KX070 (1024x600) (X2600) (lvds接口)"
    select APP_libmcu_x2600_fb
    depends on APP_libmcu_x2600

config APP_libmcu_device_x2600_kx070_backlight_pin
    string "gpio backlight pin(lcd backlight使能引脚)"
    choice from SOC_GPIO_PINS
    default -1

config APP_libmcu_device_x2600_kx070_backlight_level
    int "gpio backlight level(lcd backlight使能引脚 有效电平)"
    default 1

config APP_libmcu_device_x2600_kx070_rst_pin
    string "gpio reset pin(lcd 复位引脚)"
    choice from SOC_GPIO_PINS
    default -1

config APP_libmcu_device_x2600_kx070_rst_level
    int "gpio reset level(lcd 复位引脚 有效电平)"
    default 0

config APP_libmcu_device_x2600_kx070_power_pin
    string "gpio power pin(lcd power使能引脚)"
    choice from SOC_GPIO_PINS
    default -1

config APP_libmcu_device_x2600_kx070_power_level
    string "gpio power level(lcd power使能引脚 有效电平)"
    default 1

config APP_libmcu_device_x2600_kx070_power_en_pin
    string "gpio power_en pin(lcd power_en使能引脚)"
    choice from SOC_GPIO_PINS
    default -1

config APP_libmcu_device_x2600_kx070_power_en_level
    string "gpio power_en level(lcd power_en使能引脚 有效电平)"
    default 1

endmenu # APP_libmcu_device_x2600_lcd_kx070
```

## vendor/libmcu/drivers/Config.in
```kconfig
menuconfig APP_libmcu_driver
    bool "驱动(软件/接口)"
    default y

source drivers/console/Config.in
source drivers/hrtimer/Config.in

config APP_libmcu_driver_irq
    bool

config APP_libmcu_driver_clk
    bool

config APP_libmcu_driver_gpio
    bool

config APP_libmcu_driver_uart
    bool

config APP_libmcu_driver_systick
    bool

config APP_libmcu_driver_tcu
    bool

config APP_libmcu_driver_adc
    bool

config APP_libmcu_driver_i2c
    bool

config APP_libmcu_driver_pwm
    bool

config APP_libmcu_driver_dma
    bool

config APP_libmcu_driver_fb
    bool

config APP_libmcu_driver_spi
    bool

endmenu
```

## vendor/libmcu/drivers/console/Config.in
```kconfig
menuconfig APP_libmcu_driver_console
    bool "console 驱动(printf输出)"
    default y

choice "选择console设备类型"

config APP_libmcu_driver_console_uart
    bool "uart console"

config APP_libmcu_driver_console_none
    bool "不使用任何 console"

endchoice

config APP_libmcu_driver_console_uart_index
    int "选择 uart console id"
    depends on APP_libmcu_driver_console_uart
    default -1
    choice from APP_libmcu_soc_uart_devs

config APP_libmcu_driver_console_buad_rate
    int "串口波特率"
    depends on APP_libmcu_driver_console_uart
    default 3000000
    choice from APP_libmcu_soc_uart_buad_rate

config APP_libmcu_driver_console_no_need_to_init
    bool "不uart初始化(kernel 已经初始化了)"
    depends on APP_libmcu_driver_console_uart

endmenu
```

## vendor/libmcu/lib/Config.in
```kconfig
menuconfig APP_libmcu_lib
    bool "通用库函数"
    default y

config APP_libmcu_lib_assert
    bool "断言函数(assert)"
    default y

config APP_libmcu_lib_assert_no_file_name
    bool "    断言信息中不使用文件名"
    default y

config APP_libmcu_lib_string
    bool "字符串处理函数(strlen,strcpy,,)"
    default y

config APP_libmcu_lib_printf
    bool "printf函数"
    default y

choice "              是否支持long long类型"
    default APP_libmcu_lib_printf_not_support_longlong
    depends on APP_libmcu_lib_printf

config APP_libmcu_lib_printf_support_longlong
    bool "支持long long类型"

config APP_libmcu_lib_printf_not_support_longlong
    bool "不支持long long类型"

endchoice

config APP_libmcu_lib_printf_support_float
    bool "              支持float类型"
    depends on APP_libmcu_lib_printf
    default n

config APP_libmcu_lib_simple_printf
    bool "简单的printf函数"
    default n

config APP_libmcu_lib_ring_mem
    bool "ring_mem函数(循环缓冲区,适用于多核异构间通信)"
    default y

config APP_libmcu_lib_malloc
    bool "malloc函数"
    default y

config APP_libmcu_lib_malloc_heap_size
    int "heap size(堆空间大小)"
    default 1024
    depends on APP_libmcu_lib_malloc

config APP_libmcu_lib_nalu
    bool "h264码流解析(h264 分包)"
    default y

endmenu
```

## vendor/libmcu/newlib/Config.in
```kconfig
menu "newlib 相关选项"

config APP_libmcu_newlib_simple_syscall
    bool "newlib syscall 简单实现"
    default n

config APP_libmcu_newlib_malloc_sbrk
    bool "newlib sbrk 实现(malloc 扩张内存的回调)"
    default n

source newlib/libm_fix_longdouble/Config.in

endmenu
```

## vendor/libmcu/newlib/libm_fix_longdouble/Config.in
```kconfig
config APP_libmcu_newlib_libm_fix_longdouble
    bool "newlib libm long double simple support"
    default n
```

## vendor/libmcu/options/Config.in
```kconfig
menu "通用选项"

config APP_libmcu_version
    int "软件版本号"
    default 0

config APP_libmcu_show_compile_time
    bool "启动时显示编译时间"
    default y

menuconfig APP_libmcu_enable_jtag_debug
    bool "使用 jtag 调试程序"
    depends on APP_libmcu_x2600
    default n

config APP_libmcu_gcc_optimization_O0
    bool "gcc 强制使用-O0选项，gcc优化选项配置无效"
    default y

endmenu


array APP_libmcu_gcc_optimizations
    string "gcc 优化选项"
    item "-O0" -O0
    item "-O1" -O1
    item "-O2" -O2
    item "-O3" -O3
    item "-Os" -Os
    item "-Ofast" -Ofast
    item "默认选项"

config APP_libmcu_gcc_optimization
    string "gcc 优化选项"
    choice from APP_libmcu_gcc_optimizations
    default -Os

config APP_libmcu_gcc_function_sections
    bool "-ffunction-sections (配合--gc-sections优化多余的函数)"
    select APP_libmcu_gcc_gc_sections
    default y

config APP_libmcu_gcc_data_sections
    bool "-fdata-sections (配合--gc-sections优化多余的数据)"
    select APP_libmcu_gcc_gc_sections
    default y

config APP_libmcu_gcc_gc_sections
    bool "--gc-sections (优化不使用的段)"
    default y

config APP_libmcu_simple_irq_handle
    bool "用户自定义中断处理函数(用于去掉irq函数回调数据)"
    default n

config APP_libmcu_tcsm_text_section
    bool "使用内部tcsm 运行实时性要求较高的代码段"
    default n

config APP_libmcu_ddr_text_section
    bool "使用 ddr 运行占用内存较大的代码段"
    default n

endmenu
```

## vendor/libmcu/soc/Config.in
```kconfig
choice "选择对应cpu平台"

config APP_libmcu_choice_x2000
    bool "x2000 片上小核"
    select APP_libmcu_x2000

config APP_libmcu_choice_x1600
    bool "x1600 片上小核"
    select APP_libmcu_x1600

config APP_libmcu_choice_x1000
    bool "x1000 片上小核"
    select APP_libmcu_x1000

config APP_libmcu_choice_x2580
    bool "x2580 片上riscv小核"
    select APP_libmcu_x2580

config APP_libmcu_choice_x2600
    bool "x2600 片上riscv小核"
    select APP_libmcu_x2600

endchoice

source soc/x2000/Config.in
source soc/x1600/Config.in
source soc/x1000/Config.in
source soc/x2580/Config.in
source soc/x2600/Config.in
```

## vendor/libmcu/soc/x1000/Config.in
```kconfig
menuconfig APP_libmcu_x1000
    bool "x1000 小核配置"
    depends on APP_libmcu_choice_x1000

config APP_libmcu_x1000_irq
    bool "irq 中断处理驱动"
    default y

config APP_libmcu_x1000_clk
    bool "clk 驱动"
    select APP_libmcu_driver_clk
    default y

config APP_libmcu_x1000_gpio
    bool "gpio 驱动"
    select APP_libmcu_driver_gpio
    default y

source soc/x1000/config_uart.in

endmenu
```

## vendor/libmcu/soc/x1600/Config.in
```kconfig
menuconfig APP_libmcu_x1600
    bool "x1600 小核配置"
    depends on APP_libmcu_choice_x1600

config APP_libmcu_x1600_irq
    bool "irq 中断处理驱动"
    select APP_libmcu_driver_irq
    default y

config APP_libmcu_x1600_clk
    bool "clk 驱动"
    select APP_libmcu_driver_clk
    default y

config APP_libmcu_x1600_gpio
    bool "gpio 驱动"
    select APP_libmcu_driver_gpio
    default y
    help
        使用该驱动需要在 kernel 内勾选 CONFIG_INGENIC_DISABLE_GPIO_UAE_SHADOW

config APP_libmcu_x1600_systick
    bool "systick timer驱动"
    select APP_libmcu_driver_systick

config APP_libmcu_x1600_tcu
    bool "tcu 驱动(gpio 时钟计数捕获)"
    select APP_libmcu_driver_tcu
    default y

config APP_libmcu_x1600_adc
    bool "adc 驱动"
    select APP_libmcu_driver_adc
    default n

source soc/x1600/config_uart.in
source soc/x1600/config_i2c.in
endmenu
```

## vendor/libmcu/soc/x2000/Config.in
```kconfig
menuconfig APP_libmcu_x2000
    bool "x2000 小核配置"
    depends on APP_libmcu_choice_x2000

config APP_libmcu_x2000_irq
    bool "irq 中断处理驱动"
    select APP_libmcu_driver_irq
    default y

config APP_libmcu_x2000_clk
    bool "clk 驱动"
    select APP_libmcu_driver_clk
    default y

config APP_libmcu_x2000_gpio
    bool "gpio 驱动"
    select APP_libmcu_driver_gpio
    default y
    help
        使用该驱动需要在 kernel 内勾选 CONFIG_INGENIC_DISABLE_GPIO_UAE_SHADOW

config APP_libmcu_x2000_systick
    bool "systick timer驱动"
    select APP_libmcu_driver_systick

config APP_libmcu_x2000_tcu
    bool "tcu 驱动(gpio 时钟计数捕获)"
    select APP_libmcu_driver_tcu
    default y

config APP_libmcu_x2000_adc
    bool "adc 驱动"
    select APP_libmcu_driver_adc
    default n

source soc/x2000/config_i2c.in

source soc/x2000/config_uart.in
source soc/x2000/config_pwm.in

endmenu
```

## vendor/libmcu/soc/x2580/Config.in
```kconfig
menuconfig APP_libmcu_x2580
    bool "x2580 小核配置"
    depends on APP_libmcu_choice_x2580
    select APP_libmcu_newlib_simple_syscall
    select APP_libmcu_newlib_malloc_sbrk

config APP_libmcu_x2580_libm_fix_longdouble
    bool
    depends on APP_libmcu_libcxx
    select APP_libmcu_newlib_libm_fix_longdouble
    default y

menu "memory 选项"
config APP_libmcu_x2580_mem_start
    int "memory 起始地址"
    default 0x5c00000

config APP_libmcu_x2580_mem_size
    int "memory 大小(单位字节)"
    default 0x100000

config APP_libmcu_x2580_stack_size
    int "main stack 栈大小(单位字节)"
    default 8192

config APP_libmcu_x2580_data_from_host_size
    int "核间通信 大核到小核 ringbuffer的大小"
    default 256

config APP_libmcu_x2580_data_to_host_size
    int "核间通信 小核到大核 ringbuffer的大小"
    default 256

endmenu

menuconfig APP_libmcu_x2580_uart
    bool "uart 驱动"
    select APP_libmcu_driver_uart

array APP_libmcu_soc_uart_devs
    int "soc uart 列表"
    item "不使用 uart" -1
    item "uart0" 0
    item "uart1" 1
    item "uart2" 2
    item "uart3" 3
    item "uart4" 4
    item "uart5" 5

endmenu

config APP_libmcu_x2580_gpio
    bool "gpio驱动"
    select APP_libmcu_driver_gpio
    default y
    help
        使用该驱动需要在 kernel 内勾选 CONFIG_INGENIC_DISABLE_GPIO_UAE_SHADOW

config APP_libmcu_x2580_systick
    bool "systick timer驱动"
    select APP_libmcu_driver_systick
    default y

config APP_libmcu_x2580_clk
    bool "clk 驱动"
    select APP_libmcu_driver_clk
    default y

config APP_libmcu_x2580_irq
    bool "irq 中断处理驱动"
    select APP_libmcu_driver_irq
    default y

config APP_libmcu_x2580_uncache_mem_size
    int "uncache 内存大小(必须4k对齐，而且是2的幂次方)"
    default 4096

source soc/x2580/config_i2c.in

endmenu # APP_libmcu_x2580
```

## vendor/libmcu/soc/x2600/Config.in
```kconfig
menuconfig APP_libmcu_x2600
    bool "x2600 小核配置"
    depends on APP_libmcu_choice_x2600
    select APP_libmcu_newlib_simple_syscall
    select APP_libmcu_newlib_malloc_sbrk

config APP_libmcu_x2600_libm_fix_longdouble
    bool
    depends on APP_libmcu_libcxx
    select APP_libmcu_newlib_libm_fix_longdouble
    default y

menu "memory 选项"
config APP_libmcu_x2600_mem_start
    int "memory 起始地址"
    default 0x7000000

config APP_libmcu_x2600_mem_size
    int "memory 大小(单位字节)"
    default 0x1000000

config APP_libmcu_x2600_stack_size
    int "main stack 栈大小(单位字节)"
    default 8192
    help
        "当代码主体运行在 tcsm 上, 推荐填入 1024"

config APP_libmcu_x2600_data_from_host_size
    int "核间通信 大核到小核 ringbuffer的大小"
    default 256

config APP_libmcu_x2600_data_to_host_size
    int "核间通信 小核到大核 ringbuffer的大小"
    default 256

choice "选择代码运行主体所在内存段"
    default APP_libmcu_x2600_in_ddr
config APP_libmcu_x2600_in_ddr
    bool "主体运行在 ddr 上"
    select APP_libmcu_x2600_run_in_ddr
config APP_libmcu_x2600_in_tcsm
    bool "主体运行在 tcsm 上"
    select APP_libmcu_x2600_run_in_tcsm
endchoice

config APP_libmcu_x2600_run_in_ddr
    bool

config APP_libmcu_x2600_run_in_tcsm
    bool

config APP_libmcu_x2600_stack_in_tcsm
    bool "main stack 放入tcsm中,以提高实时性"
    depends on APP_libmcu_x2600_run_in_ddr
    select APP_libmcu_tcsm_text_section
    default y

config APP_libmcu_x2600_uncache_mem_size
    int "uncache 内存大小(必须4k对齐，而且是2的幂次方)"
    depends on APP_libmcu_x2600_run_in_ddr
    default 4096

config APP_libmcu_x2600_stack_in_ddr
    bool "占用内存较大的函数或数据 放入ddr中,以减少占用tcsm"
    depends on APP_libmcu_x2600_run_in_tcsm
    select APP_libmcu_ddr_text_section
    default y

endmenu

config APP_libmcu_x2600_adc
    bool "adc 驱动"
    select APP_libmcu_driver_adc
    default n

config APP_libmcu_x2600_tcu
    bool "tcu 驱动(gpio 时钟计数捕获)"
    select APP_libmcu_driver_tcu
    default n

config APP_libmcu_x2600_gpio
    bool "gpio驱动"
    select APP_libmcu_driver_gpio
    default y

config APP_libmcu_x2600_systick
    bool "systick timer驱动"
    select APP_libmcu_driver_systick
    default y

config APP_libmcu_x2600_clk
    bool "clk 驱动"
    select APP_libmcu_driver_clk
    default y

config APP_libmcu_x2600_irq
    bool "irq 中断处理驱动"
    select APP_libmcu_driver_irq
    default y

config APP_libmcu_x2600_felix
    bool "h264 硬件解码驱动"
    default n

config APP_libmcu_x2600_dma
    bool "dma驱动"
    select APP_libmcu_driver_dma
    default n

menuconfig APP_libmcu_x2600_pwm
    bool "pwm驱动"
    select APP_libmcu_driver_pwm
    default n

config APP_libmcu_x2600_pwm_dma_trig_num
    int "pwm dma fifo 触发数目(64 - this >= fifo num时, DMA触发)"
    default 32

endmenu

menuconfig APP_libmcu_x2600_tpc
    bool "tpc 驱动"
    default n


config APP_libmcu_x2600_tpc_motor_num
    int "TPC 电机个数(1 ~ 2)"
    default 2
    help
        "若设置为1，可作为一个4相8路电机使用，若设置为 2， 可作为两个2相4路电机使用"

endmenu

config APP_libmcu_x2600_nemc
    bool "nemc 驱动"
    default n

source soc/x2600/def_gpio_pins.in
source soc/x2600/config_uart.in
source soc/x2600/config_fb.in
source soc/x2600/config_spi.in
source soc/x2600/config_i2c.in

endmenu # APP_libmcu_x2600
```

## vendor/libmcu/third_party/libcxx/Config.in
```kconfig
config APP_libmcu_libcxx
    bool "libcxx(c++ support)"
config APP_libmcu_libcxx_rtti
    bool "    支持c++动态类型判断, typeid(dynamic_cast)"
    default n
    depends on APP_libmcu_libcxx
config APP_libmcu_libcxx_thread
    bool
    default n
```
